DATAPOINTS BDRVR SN74LXC8T245_Q1_io_5p0_Typ_27degC
MODEL_VERSION=2.0
PullUpReference=5
PullDownReference=0
GroundClampReference=0

DATAPOINTS AC_PARAM
dVGateOpen=1
dVGateClose=0
ENABLE_ON_VOLT=1
ENABLE_OFF_VOLT=0
RISE_TIME=1.19667e-09
FALL_TIME=7.5e-10
dVdtr=4.17827e+09
dVdtf=6.66667e+09
END AC_PARAM

DATAPOINTS LOGIC_PARAM
VHI_MIN=3.85
VLO_MAX=1.35
END LOGIC_PARAM

DATAPOINTS VI ground_clamp
-5.5 -0.89705
-5.245 -0.8463
-4.995 -0.79663
-4.755 -0.74902
-4.52 -0.70249
-4.3 -0.65901
-4.085 -0.6166
-3.87 -0.57429
-3.67 -0.53503
-3.475 -0.49685
-3.385 -0.47926
-3.29 -0.46072
-3.195 -0.44222
-3.11 -0.42569
-3.02 -0.40821
-2.93 -0.39077
-2.85 -0.37529
-2.765 -0.35887
-2.685 -0.34346
-2.605 -0.32807
-2.525 -0.31272
-2.45 -0.29837
-2.375 -0.28404
-2.3 -0.26976
-2.225 -0.25552
-2.155 -0.24226
-2.085 -0.22904
-2.015 -0.21587
-1.945 -0.20275
-1.88 -0.19061
-1.815 -0.17852
-1.755 -0.16741
-1.695 -0.15634
-1.635 -0.14533
-1.575 -0.13438
-1.52 -0.1244
-1.465 -0.11449
-1.415 -0.10553
-1.365 -0.096635
-1.32 -0.088691
-1.275 -0.080813
-1.23 -0.073008
-1.19 -0.066142
-1.15 -0.059354
-1.115 -0.053489
-1.08 -0.047705
-1.05 -0.042824
-1.025 -0.03882
-1.01 -0.03645
-1 -0.034885
-0.98 -0.031794
-0.97 -0.030271
-0.96 -0.028764
-0.95 -0.027275
-0.94 -0.025804
-0.93 -0.024355
-0.925 -0.023639
-0.915 -0.022226
-0.91 -0.021529
-0.9 -0.020156
-0.895 -0.019481
-0.885 -0.018157
-0.88 -0.017508
-0.87 -0.016241
-0.865 -0.015623
-0.855 -0.014421
-0.84 -0.012716
-0.83 -0.011653
-0.82 -0.010654
-0.81 -0.0097255
-0.8 -0.008872
-0.79 -0.008096
-0.78 -0.007398
-0.77 -0.0067757
-0.76 -0.006224
-0.745 -0.0055123
-0.735 -0.0051023
-0.73 -0.0049133
-0.72 -0.0045621
-0.71 -0.0042405
-0.7 -0.0039424
-0.685 -0.0035293
-0.67 -0.0031471
-0.655 -0.0027887
-0.64 -0.0024499
-0.62 -0.002025
-0.595 -0.001535
-0.575 -0.001177
-0.555 -0.0008524
-0.54 -0.00063374
-0.525 -0.00043973
-0.51 -0.00027458
-0.495 -0.00014391
-0.48 -5.4743e-05
-0.465 -1.5272e-05
-0.45 -9.5607e-06
-0.435 -6.1005e-06
-0.41 -2.8408e-06
-0.225 -9.9652e-09
5 4.2753e-11
END VI ground_clamp

DATAPOINTS VI PULL_UP
5.5 0.19257
5.39 0.18868
5.085 0.17824
4.72 0.16656
4.46 0.15971
4.25 0.15433
4.15 0.15186
4.06 0.1497
3.915 0.14644
3.79 0.14398
3.69 0.1424
3.555 0.14083
3.465 0.13985
3.39 0.13899
3.34 0.13847
3.3 0.13809
3.27 0.13784
3.24 0.13763
3.215 0.13748
3.185 0.13735
3.14 0.1373
3.1 0.13747
3.055 0.13812
3.02 0.13939
2.985 0.14132
2.945 0.14424
2.885 0.14945
2.765 0.15918
2.71 0.16347
2.67 0.16652
2.63 0.1695
2.59 0.17241
2.52 0.17755
2.445 0.18231
2.36 0.18661
2.315 0.18842
2.27 0.18991
2.225 0.1911
2.175 0.19207
2.135 0.19258
2.09 0.19287
2.015 0.19273
1.935 0.19172
1.86 0.19
1.78 0.18735
1.715 0.18459
1.65 0.18129
1.59 0.17777
1.525 0.17342
1.46 0.16848
1.395 0.16294
1.33 0.15688
1.265 0.15039
1.19 0.14246
1.105 0.13295
0.95 0.11465
0.875 0.10556
0.715 0.085853
0.465 0.055631
0.115 0.013484
-0.085 -0.0097642
-0.27 -0.030286
-0.39 -0.043092
-0.505 -0.054992
-0.625 -0.067019
-0.74 -0.078172
-0.86 -0.08942
-0.975 -0.099826
-1.09 -0.10987
-1.205 -0.11954
-1.335 -0.13004
-1.465 -0.14006
-1.595 -0.14962
-1.725 -0.15871
-1.855 -0.16734
-1.985 -0.17549
-2.115 -0.18318
-2.245 -0.1904
-2.375 -0.19715
-2.505 -0.20344
-2.635 -0.20925
-2.765 -0.2146
-2.895 -0.21948
-3.025 -0.22389
-3.155 -0.22783
-3.285 -0.2313
-3.385 -0.23366
-3.49 -0.23583
-3.605 -0.23786
-3.69 -0.23913
-3.795 -0.24041
-3.895 -0.24135
-3.995 -0.24202
-4.095 -0.2424
-4.17 -0.24255
-4.285 -0.24398
-4.405 -0.24547
-4.555 -0.24733
-4.725 -0.24944
-11 -0.32749
END VI PULL_UP

DATAPOINTS VI pull_down
-5.5 -0.25384
-5.245 -0.24897
-5 -0.24377
-4.745 -0.23784
-4.485 -0.23126
-4.225 -0.22415
-3.96 -0.21638
-3.695 -0.20806
-3.43 -0.19922
-3.165 -0.18983
-2.9 -0.17989
-2.635 -0.16936
-2.38 -0.15866
-2.125 -0.14734
-1.88 -0.13581
-1.645 -0.12408
-1.42 -0.11211
-1.275 -0.10395
-1.14 -0.095968
-1.025 -0.088827
-0.89 -0.07995
-0.785 -0.072593
-0.69 -0.065546
-0.595 -0.058058
-0.555 -0.054729
-0.515 -0.051247
-0.47 -0.047043
-0.43 -0.043055
0.06 0.0059952
0.255 0.025152
0.465 0.045217
0.675 0.064663
0.795 0.075484
0.915 0.086082
1.035 0.096451
1.15 0.10617
1.265 0.11565
1.38 0.1249
1.495 0.13391
1.605 0.14229
1.705 0.1497
1.8 0.15655
1.9 0.16355
1.995 0.17
2.09 0.17623
2.185 0.18226
2.28 0.18806
2.375 0.19363
2.47 0.19896
2.56 0.20378
2.65 0.20837
2.74 0.21271
2.83 0.21679
2.915 0.22041
3 0.22378
3.085 0.2269
3.185 0.23022
3.28 0.23301
3.375 0.23543
3.47 0.23745
3.565 0.23906
3.655 0.24018
3.745 0.24088
3.83 0.24114
3.955 0.24153
4.88 0.24452
5.43 0.24628
5.635 0.24702
5.865 0.24811
6.045 0.24957
6.25 0.25175
6.37 0.25322
6.515 0.25515
6.7 0.25789
6.9 0.26118
7.16 0.26588
7.4 0.27062
7.69 0.27682
7.995 0.28386
8.3 0.29141
8.61 0.29953
8.95 0.30891
9.295 0.31889
9.535 0.32606
9.79 0.33387
9.935 0.33837
10.025 0.34119
10.055 0.34213
10.11 0.34386
10.16 0.34543
10.205 0.34685
10.255 0.34843
10.44 0.35426
10.575 0.3585
10.67 0.36144
10.76 0.36419
10.85 0.36688
10.94 0.36945
10.965 0.37014
11 0.37108
END VI pull_down
datapoints tv RisingWaveform name=rise_1 R_fixture=2000 V_fixture=0 
0 4.4736e-10
1.49e-09 8.3674e-06
1.625e-09 -0.00013164
1.64e-09 -0.00014571
1.66e-09 -0.00016278
1.715e-09 -5.5185e-05
1.74e-09 0.00066758
1.76e-09 0.0014415
1.775e-09 0.0021361
1.79e-09 0.0029285
1.805e-09 0.0038187
1.82e-09 0.0043134
1.835e-09 0.0046588
1.85e-09 0.004942
1.865e-09 0.0051631
1.88e-09 0.0033571
1.895e-09 -0.00069441
1.91e-09 -0.0060914
1.935e-09 -0.018252
1.955e-09 -0.030822
1.99e-09 -0.054803
2.02e-09 -0.068655
2.05e-09 -0.079368
2.09e-09 -0.084786
2.115e-09 -0.080244
2.14e-09 -0.068369
2.165e-09 -0.046477
2.185e-09 -0.021187
2.22e-09 0.043765
2.245e-09 0.10144
2.27e-09 0.16562
2.295e-09 0.23783
2.32e-09 0.31415
2.345e-09 0.39573
2.365e-09 0.46502
2.385e-09 0.5361
2.405e-09 0.60993
2.425e-09 0.68651
2.445e-09 0.76483
2.465e-09 0.84463
2.485e-09 0.92637
2.505e-09 1.01
2.52e-09 1.0738
2.545e-09 1.1818
2.57e-09 1.2915
2.595e-09 1.4027
2.62e-09 1.5155
2.65e-09 1.6524
2.675e-09 1.7676
2.705e-09 1.9075
2.735e-09 2.0484
2.77e-09 2.2137
2.805e-09 2.3805
2.845e-09 2.5713
2.885e-09 2.7608
2.935e-09 2.9903
2.985e-09 3.21
3.03e-09 3.3968
3.075e-09 3.5718
3.135e-09 3.7874
3.195e-09 3.9833
3.25e-09 4.1451
3.28e-09 4.2244
3.31e-09 4.2974
3.365e-09 4.4132
3.425e-09 4.5173
3.49e-09 4.6083
3.555e-09 4.6811
3.6e-09 4.7223
3.65e-09 4.7607
3.695e-09 4.7895
3.745e-09 4.8141
3.845e-09 4.8508
3.95e-09 4.8778
4.015e-09 4.89
4.08e-09 4.9
4.165e-09 4.9102
4.255e-09 4.9184
4.345e-09 4.9248
4.435e-09 4.93
4.49e-09 4.9327
4.55e-09 4.9353
4.61e-09 4.9376
4.66e-09 4.9394
4.71e-09 4.941
4.765e-09 4.9427
4.825e-09 4.9443
4.885e-09 4.9459
5.01e-09 4.9487
5.165e-09 4.9516
5.345e-09 4.9545
5.525e-09 4.9569
5.745e-09 4.9594
5.99e-09 4.9617
6.28e-09 4.9639
6.655e-09 4.9663
7.725e-09 4.9707
9.4e-09 4.9743
1.555e-08 4.9776
2.9995e-08 4.9779
End tv RisingWaveform name=rise_1
datapoints tv RisingWaveform name=rise_2 R_fixture=2000 V_fixture=5 
0 0.024836
1.49e-09 0.024845
1.615e-09 0.024715
1.635e-09 0.024695
1.655e-09 0.024678
1.675e-09 0.024663
1.715e-09 0.024782
1.75e-09 0.025869
1.765e-09 0.026498
1.78e-09 0.027225
1.795e-09 0.028049
1.81e-09 0.028885
1.825e-09 0.029284
1.84e-09 0.029625
1.85e-09 0.029819
1.865e-09 0.030061
1.885e-09 0.027114
1.9e-09 0.022681
1.925e-09 0.012286
1.945e-09 0.0011885
1.98e-09 -0.021743
2.01e-09 -0.038007
2.045e-09 -0.049455
2.085e-09 -0.053419
2.105e-09 -0.048944
2.13e-09 -0.036465
2.15e-09 -0.01717
2.175e-09 0.017265
2.19e-09 0.043732
2.21e-09 0.085725
2.235e-09 0.14825
2.255e-09 0.20329
2.28e-09 0.28005
2.305e-09 0.36412
2.325e-09 0.4333
2.35e-09 0.52462
2.385e-09 0.65998
2.405e-09 0.7407
2.425e-09 0.82416
2.445e-09 0.90917
2.465e-09 0.99541
2.5e-09 1.1506
2.52e-09 1.2416
2.545e-09 1.3569
2.57e-09 1.4738
2.595e-09 1.5919
2.62e-09 1.7114
2.645e-09 1.8319
2.675e-09 1.9777
2.705e-09 2.1247
2.74e-09 2.2966
2.77e-09 2.4448
2.815e-09 2.6672
2.855e-09 2.8622
2.905e-09 3.0974
2.945e-09 3.2768
2.985e-09 3.4479
3.025e-09 3.6091
3.08e-09 3.8153
3.14e-09 4.02
3.2e-09 4.2031
3.225e-09 4.2724
3.25e-09 4.3361
3.275e-09 4.395
3.305e-09 4.4595
3.36e-09 4.5609
3.415e-09 4.6442
3.475e-09 4.7167
3.525e-09 4.7663
3.57e-09 4.8043
3.625e-09 4.8417
3.675e-09 4.8681
3.755e-09 4.8976
3.83e-09 4.918
3.905e-09 4.9333
3.96e-09 4.9419
4.045e-09 4.9519
4.13e-09 4.9591
4.215e-09 4.9645
4.295e-09 4.9684
4.35e-09 4.9706
4.405e-09 4.9725
4.465e-09 4.9742
4.52e-09 4.9756
4.565e-09 4.9767
4.615e-09 4.9778
4.725e-09 4.9798
4.785e-09 4.9807
4.85e-09 4.9817
4.92e-09 4.9826
4.99e-09 4.9834
5.135e-09 4.985
5.335e-09 4.9867
5.445e-09 4.9875
5.695e-09 4.9891
6.2e-09 4.9916
7.03e-09 4.9943
8.495e-09 4.9969
1.471e-08 4.9997
2.9995e-08 5
End tv RisingWaveform name=rise_2
datapoints tv FallingWaveform name=fall_1 R_fixture=2000 V_fixture=5 
0 5
1.735e-09 5
1.9e-09 5.0005
1.97e-09 4.9992
2.005e-09 4.9984
2.035e-09 4.9976
2.06e-09 4.9971
2.085e-09 4.9965
2.12e-09 4.9959
2.17e-09 4.9959
2.22e-09 5.0003
2.265e-09 5.0052
2.295e-09 5.0077
2.325e-09 5.0101
2.355e-09 5.0012
2.37e-09 4.9939
2.385e-09 4.9849
2.405e-09 4.9702
2.425e-09 4.9525
2.445e-09 4.9319
2.465e-09 4.9099
2.49e-09 4.8794
2.57e-09 4.7686
2.61e-09 4.7092
2.625e-09 4.6862
2.65e-09 4.6462
2.67e-09 4.6129
2.69e-09 4.5785
2.71e-09 4.543
2.73e-09 4.5044
2.75e-09 4.4633
2.775e-09 4.4091
2.795e-09 4.3633
2.815e-09 4.3151
2.84e-09 4.2378
2.865e-09 4.1515
2.89e-09 4.0561
2.915e-09 3.9517
2.94e-09 3.8358
2.96e-09 3.7359
2.985e-09 3.602
3.02e-09 3.401
3.05e-09 3.2324
3.075e-09 3.088
3.105e-09 2.9102
3.14e-09 2.7075
3.18e-09 2.481
3.22e-09 2.258
3.255e-09 2.0751
3.29e-09 1.8992
3.315e-09 1.7781
3.35e-09 1.6189
3.375e-09 1.511
3.405e-09 1.3877
3.425e-09 1.3095
3.46e-09 1.1802
3.49e-09 1.0769
3.52e-09 0.98034
3.545e-09 0.90499
3.575e-09 0.82012
3.605e-09 0.74253
3.635e-09 0.67216
3.69e-09 0.5584
3.75e-09 0.45489
3.815e-09 0.36246
3.86e-09 0.30815
3.905e-09 0.25997
3.945e-09 0.22282
3.99e-09 0.18802
4.04e-09 0.15757
4.105e-09 0.12677
4.155e-09 0.10878
4.205e-09 0.094774
4.245e-09 0.085962
4.29e-09 0.077782
4.335e-09 0.071461
4.38e-09 0.066134
4.425e-09 0.062002
4.47e-09 0.058427
4.56e-09 0.053141
4.615e-09 0.050729
4.675e-09 0.04849
4.74e-09 0.046555
4.805e-09 0.044925
4.865e-09 0.043643
4.925e-09 0.042541
4.99e-09 0.041479
5.05e-09 0.040621
5.115e-09 0.039791
5.19e-09 0.038936
5.345e-09 0.03746
5.53e-09 0.036066
5.735e-09 0.034843
5.88e-09 0.034123
6.04e-09 0.033435
6.5e-09 0.031887
7.26e-09 0.030173
8.575e-09 0.028484
1.415e-08 0.026113
2.9995e-08 0.024924
End tv FallingWaveform name=fall_1
datapoints tv FallingWaveform name=fall_2 R_fixture=2000 V_fixture=0 
0 4.9785
1.735e-09 4.9785
1.9e-09 4.979
1.97e-09 4.9777
2.005e-09 4.9769
2.035e-09 4.9762
2.06e-09 4.9756
2.085e-09 4.9751
2.12e-09 4.9744
2.17e-09 4.9745
2.22e-09 4.9788
2.265e-09 4.9836
2.295e-09 4.9859
2.325e-09 4.988
2.355e-09 4.9787
2.37e-09 4.9712
2.385e-09 4.9619
2.405e-09 4.9467
2.42e-09 4.9333
2.435e-09 4.9181
2.46e-09 4.8904
2.485e-09 4.8596
2.565e-09 4.7454
2.6e-09 4.6916
2.62e-09 4.6598
2.64e-09 4.6267
2.66e-09 4.5921
2.68e-09 4.5564
2.7e-09 4.5194
2.72e-09 4.4805
2.74e-09 4.4375
2.765e-09 4.3802
2.79e-09 4.3191
2.815e-09 4.2539
2.83e-09 4.2044
2.85e-09 4.1327
2.87e-09 4.0545
2.895e-09 3.9476
2.915e-09 3.8549
2.94e-09 3.7305
2.965e-09 3.5964
2.995e-09 3.4224
3.015e-09 3.2989
3.05e-09 3.0937
3.085e-09 2.883
3.125e-09 2.6395
3.17e-09 2.3784
3.215e-09 2.1224
3.27e-09 1.8346
3.32e-09 1.5911
3.35e-09 1.4557
3.375e-09 1.3485
3.4e-09 1.2466
3.43e-09 1.1312
3.46e-09 1.0233
3.485e-09 0.93895
3.52e-09 0.8292
3.54e-09 0.77048
3.565e-09 0.70206
3.59e-09 0.6392
3.615e-09 0.58141
3.645e-09 0.51821
3.675e-09 0.46059
3.705e-09 0.4083
3.765e-09 0.31819
3.81e-09 0.2617
3.85e-09 0.21721
3.895e-09 0.17437
3.935e-09 0.14288
3.98e-09 0.11479
4.04e-09 0.085414
4.095e-09 0.065403
4.145e-09 0.051676
4.185e-09 0.04315
4.225e-09 0.036147
4.265e-09 0.030511
4.305e-09 0.02621
4.35e-09 0.02206
4.39e-09 0.019374
4.435e-09 0.016762
4.48e-09 0.014767
4.535e-09 0.012826
4.59e-09 0.011347
4.65e-09 0.010021
4.71e-09 0.0090077
4.77e-09 0.0081538
4.825e-09 0.0075134
4.885e-09 0.0069166
4.945e-09 0.0064035
5.005e-09 0.0059664
5.075e-09 0.0055215
5.215e-09 0.0048124
5.295e-09 0.0044872
5.375e-09 0.0042048
5.555e-09 0.0036945
5.78e-09 0.0032225
6.07e-09 0.0027807
6.485e-09 0.0023363
7.225e-09 0.0018272
2.9995e-08 7.5898e-05
End tv FallingWaveform name=fall_2

DATAPOINTS PARASITICS
C_COMP=5.79e-12
END PARASITICS

END BDRVR SN74LXC8T245_Q1_io_5p0_Typ_27degC
