DATAPOINTS BDRVR SN65MLVD040_D_DE_Typ_27degC
MODEL_VERSION=2.0
PullUpReference=3.3
PowerClampReference=3.3
GroundClampReference=0

DATAPOINTS AC_PARAM
dVGateOpen=1
dVGateClose=0
ENABLE_ON_VOLT=1
ENABLE_OFF_VOLT=0
RISE_TIME=-1
FALL_TIME=-1
dVdtr=-1
dVdtf=-1
END AC_PARAM

DATAPOINTS LOGIC_PARAM
VHI_MIN=2
VLO_MAX=0.8
END LOGIC_PARAM

DATAPOINTS VI POWER_CLAMP
3.3 8.22367e-09
3.25025 8.10467e-09
3.2005 7.98667e-09
3.15075 7.86767e-09
3.101 7.74867e-09
3.05126 7.63067e-09
3.00151 7.51267e-09
2.95176 7.39367e-09
2.90201 7.27567e-09
2.85226 7.15667e-09
2.80251 7.03867e-09
2.75276 6.92067e-09
2.70302 6.80167e-09
2.65327 6.68367e-09
2.60352 6.56567e-09
2.55377 6.44667e-09
2.50402 6.32967e-09
2.45427 6.21067e-09
2.40452 6.09267e-09
2.35477 5.97367e-09
2.30503 5.85467e-09
2.25528 5.73667e-09
2.20553 5.61767e-09
2.15578 5.49867e-09
2.10603 5.37967e-09
2.05628 5.26167e-09
2.00653 5.14167e-09
1.95678 5.02267e-09
1.90704 4.90267e-09
1.85729 4.78367e-09
1.80754 4.66467e-09
1.75779 4.54467e-09
1.70804 4.42467e-09
1.65829 4.30467e-09
1.60854 4.18467e-09
1.50904 3.94467e-09
1.4593 3.82367e-09
1.40955 3.70267e-09
1.3598 3.58167e-09
1.31005 3.46067e-09
1.2603 3.33867e-09
1.21055 3.21667e-09
1.1608 3.09467e-09
1.06131 2.84867e-09
1.01156 2.72467e-09
0.961809 2.60167e-09
0.91206 2.47667e-09
0.862312 2.35167e-09
0.812563 2.22667e-09
0.762814 2.09967e-09
0.713065 1.97267e-09
0.663317 1.84567e-09
0.613568 1.71667e-09
0.563819 1.58667e-09
0.51407 1.45567e-09
0.464322 1.32467e-09
0.414573 1.19067e-09
0.364824 1.05667e-09
0.315075 9.19667e-10
0.265327 7.82667e-10
0.215578 6.41667e-10
0.165829 4.99667e-10
0.11608 3.54667e-10
0.0663317 2.05667e-10
0 4.95481e-11
-0.182412 4.95224e-11
-0.232161 4.87363e-11
-0.28191 4.79502e-11
-0.530653 4.40199e-11
-0.779397 4.00895e-11
-0.878894 3.85174e-11
-0.928643 3.77313e-11
-0.978392 3.69453e-11
-1.02814 3.61592e-11
-1.07789 3.53731e-11
-1.22714 3.30149e-11
-1.27688 3.22289e-11
-1.42613 2.98706e-11
-1.47588 2.90846e-11
-1.62513 2.67264e-11
-1.67487 2.59403e-11
-1.82412 2.35821e-11
-1.87387 2.2796e-11
-2.02312 2.04378e-11
-2.07286 1.96517e-11
-2.22211 1.72935e-11
-2.27186 1.65075e-11
-2.42111 1.41492e-11
-2.47085 1.33632e-11
-2.57035 1.1791e-11
-2.6201 1.1005e-11
-2.76935 8.64676e-12
-2.81909 7.86069e-12
-2.96834 5.50249e-12
-3.01809 4.71642e-12
-3.16734 2.35821e-12
-3.31658 0
-3.56533 0
-3.61508 0
-6.6 0
END VI POWER_CLAMP

DATAPOINTS VI ground_clamp
-3.3 -0.0143471
-3.25025 -0.0140256
-3.2005 -0.0137058
-3.15075 -0.0133876
-3.101 -0.0130711
-3.05126 -0.0127563
-3.00151 -0.0124431
-2.95176 -0.0121316
-2.90201 -0.0118218
-2.85226 -0.0115137
-2.80251 -0.0112072
-2.75276 -0.0109025
-2.70302 -0.0105994
-2.65327 -0.0102981
-2.60352 -0.00999845
-2.55377 -0.00970053
-2.50402 -0.00940433
-2.45427 -0.00910986
-2.40452 -0.00881714
-2.35477 -0.00852616
-2.30503 -0.00823694
-2.25528 -0.0079495
-2.20553 -0.00766385
-2.15578 -0.00738
-2.10603 -0.00709797
-2.05628 -0.00681778
-2.00653 -0.00653946
-1.95678 -0.00626302
-1.90704 -0.00598851
-1.85729 -0.00571594
-1.80754 -0.00544537
-1.75779 -0.00517685
-1.70804 -0.00491042
-1.65829 -0.00464615
-1.60854 -0.00438413
-1.55879 -0.00412446
-1.50904 -0.00386725
-1.4593 -0.00361266
-1.40955 -0.00336087
-1.3598 -0.00311213
-1.31005 -0.00286673
-1.2603 -0.00262508
-1.21055 -0.00238765
-1.1608 -0.00215505
-1.11105 -0.001928
-1.06131 -0.00170723
-1.01156 -0.00149337
-0.961809 -0.0012868
-0.91206 -0.00108765
-0.862312 -0.000896075
-0.812563 -0.000712632
-0.762814 -0.000538851
-0.713065 -0.00037801
-0.663317 -0.000236705
-0.613568 -0.000126827
-0.563819 -5.86685e-05
-0.51407 -2.38898e-05
-0.464322 -8.59505e-06
-0.414573 -3.23432e-06
-0.364824 -1.63466e-06
-0.315075 -1.12886e-06
-0.265327 -8.88231e-07
-0.215578 -7.05385e-07
-0.165829 -5.35847e-07
-0.11608 -3.71109e-07
0 -1.08928e-11
0.0829146 2.53355e-07
0.182412 5.44465e-07
0.232161 6.84733e-07
0.28191 8.21475e-07
0.331658 9.54693e-07
0.381407 1.08439e-06
0.431156 1.21055e-06
0.480905 1.3332e-06
0.530653 1.45232e-06
0.580402 1.56791e-06
0.679899 1.78853e-06
0.729648 1.89356e-06
0.779397 1.99506e-06
0.878894 2.18749e-06
0.978392 2.36584e-06
1.07789 2.53009e-06
1.17739 2.68026e-06
1.22714 2.75007e-06
1.32663 2.87913e-06
1.37638 2.93838e-06
1.42613 2.99412e-06
1.47588 3.04635e-06
1.57538 3.14029e-06
1.62513 3.18201e-06
1.72462 3.25499e-06
1.82412 3.31415e-06
1.87387 3.33861e-06
2.02312 3.39238e-06
2.07286 3.40423e-06
2.17236 3.42035e-06
2.27186 3.42904e-06
2.42111 3.43484e-06
2.6201 3.43776e-06
6.6 3.44106e-06
END VI ground_clamp

DATAPOINTS PARASITICS
C_COMP=3.2931e-12
END PARASITICS

END BDRVR SN65MLVD040_D_DE_Typ_27degC
DATAPOINTS BDRVR ZYNQUPLUSRFSOC_HD_LVCMOS33_S_12_Typ_27degC
MODEL_VERSION=2.0
PullUpReference=3.3
PullDownReference=0
PowerClampReference=3.3
GroundClampReference=0

DATAPOINTS AC_PARAM
dVGateOpen=1
dVGateClose=0
ENABLE_ON_VOLT=1
ENABLE_OFF_VOLT=0
RISE_TIME=9.72667e-10
FALL_TIME=1.26767e-09
dVdtr=2.04044e+09
dVdtf=1.58875e+09
END AC_PARAM

DATAPOINTS LOGIC_PARAM
VHI_MIN=2
VLO_MAX=0.8
END LOGIC_PARAM

DATAPOINTS VI POWER_CLAMP
3.3 12.8348
3.256 12.5236
3.212 12.2123
3.168 11.9224
3.124 11.6565
3.08 11.3906
3.036 11.1247
2.992 10.8588
2.948 10.6068
2.904 10.3705
2.86 10.1342
2.816 9.8978
2.772 9.6615
2.728 9.4241
2.684 9.1856
2.64 8.9471
2.596 8.7085
2.552 8.47
2.508 8.2285
2.464 7.9836
2.42 7.7388
2.376 7.494
2.332 7.2491
2.288 7.0023
2.244 6.7533
2.2 6.5043
2.156 6.2553
2.112 6.0062
2.068 5.7585
2.024 5.5123
1.98 5.2661
1.936 5.0199
1.892 4.7737
1.848 4.5243
1.804 4.2713
1.76 4.0183
1.716 3.7653
1.672 3.5104
1.628 3.2479
1.584 2.9854
1.54 2.7217
1.496 2.4535
1.452 2.1853
1.408 1.9152
1.364 1.6457
1.32 1.3773
1.276 1.1143
1.232 0.859634
1.188 0.622493
1.144 0.413258
1.1 0.240789
1.056 0.126813
1.012 0.0670199
0.968 0.0417009
0.924 0.030722
0.88 0.0253141
0.836 0.0214744
0.792 0.0187412
0.748 0.016095
0.704 0.0134488
0.66 0.0108026
0.616 0.0081564
0.572 0.0065564
0.528 0.0051266
0.484 0.0036969
0.44 0.0022672
0.396 0.000837477
0.352 0.000527776
0.308 0.000400404
0.264 0.000273032
0.22 0.00014566
0.176 1.82875e-05
0.132 3.09721e-07
0.088 1.40278e-07
0.044 1.95647e-08
0 1.44646e-08
END VI POWER_CLAMP

DATAPOINTS VI ground_clamp
-3.3 -8.2465
-3.212 -7.9718
-3.124 -7.6971
-3.036 -7.4224
-2.948 -7.1477
-2.86 -6.873
-2.772 -6.5983
-2.684 -6.3236
-2.596 -6.0489
-2.508 -5.7742
-2.42 -5.4995
-2.332 -5.2248
-2.244 -4.9501
-2.156 -4.6754
-2.068 -4.4007
-1.98 -4.126
-1.892 -3.8513
-1.804 -3.5766
-1.716 -3.3019
-1.628 -3.0272
-1.54 -2.7525
-1.452 -2.4778
-1.364 -2.2031
-1.276 -1.9284
-1.188 -1.6537
-1.1 -1.379
-1.012 -1.1043
-0.924 -0.829595
-0.836 -0.554894
-0.748 -0.280194
-0.66 -0.0054939
-0.572 -0.0019568
-0.484 -0.0010444
-0.396 -0.000285635
-0.308 -6.9828e-06
-0.22 -4.046e-06
-0.132 -1.1092e-06
-0.044 -1.03323e-08
0.044 -8.7393e-09
0.132 -7.737e-09
0.22 -7.0915e-09
0.308 -6.4461e-09
0.396 -6.0892e-09
0.484 -5.8622e-09
0.572 -5.6641e-09
0.66 -5.5219e-09
0.748 -5.412e-09
0.836 -5.3021e-09
0.924 -5.1591e-09
1.012 -5.0082e-09
1.1 -4.8573e-09
1.188 -4.7064e-09
1.276 -4.4346e-09
1.364 -3.757e-09
1.452 -2.2264e-09
1.54 6.14877e-10
1.628 5.0555e-09
1.716 6.8516e-09
1.804 7.6923e-09
1.892 8.2047e-09
1.98 8.5304e-09
2.068 8.6662e-09
2.156 8.7708e-09
2.244 8.8754e-09
2.332 8.9644e-09
2.42 9.0392e-09
2.508 9.1141e-09
2.596 9.189e-09
2.684 9.2638e-09
2.772 9.5237e-09
2.86 9.9498e-09
2.948 1.03759e-08
3.036 1.0802e-08
3.124 1.12281e-08
3.212 1.25109e-08
3.3 1.45636e-08
END VI ground_clamp

DATAPOINTS VI PULL_UP
3.3 0.0314067
3.19 0.0313243
3.08 0.0312419
2.97 0.0311595
2.86 0.031077
2.75 0.0309946
2.64 0.0309122
2.53 0.0308298
2.42 0.0307474
2.31 0.030665
2.2 0.0305826
2.09 0.0305002
1.98 0.0304178
1.87 0.0303353
1.76 0.0302529
1.65 0.0301705
1.54 0.0300881
1.43 0.0300057
1.32 0.0299233
1.21 0.0298409
1.1 0.0297584
0.99 0.029676
0.88 0.0295936
0.77 0.0295112
0.66 0.0294288
0.55 0.0275154
0.44 0.0240457
0.33 0.0193277
0.22 0.0132856
0.11 0.0070709
0 0.000856243
-0.11 -0.0053584
-0.22 -0.0115731
-0.33 -0.0171165
-0.44 -0.0216052
-0.55 -0.0254095
-0.66 -0.0283451
-0.77 -0.0305168
-0.88 -0.0326884
-0.99 -0.03486
-1.1 -0.0367796
-1.21 -0.0381869
-1.32 -0.0395942
-1.43 -0.0408439
-1.54 -0.0420641
-1.65 -0.0432625
-1.76 -0.0444415
-1.87 -0.0456086
-1.98 -0.046764
-2.09 -0.0479122
-2.2 -0.0490488
-2.31 -0.0517597
-2.42 -0.0549421
-2.53 -0.0560978
-2.64 -0.0572413
-2.75 -0.0583842
-2.86 -0.059513
-2.97 -0.0606343
-3.08 -0.0617433
-3.19 -0.0628229
-3.3 -0.0638939
-3.41 -0.0649648
-3.52 -0.0660357
-3.63 -0.0671067
-3.74 -0.0681747
-3.85 -0.0692415
-3.96 -0.0703623
-4.07 -0.149597
-4.18 -0.228832
-4.29 -0.308067
-4.4 -0.387302
-4.51 -0.466537
-4.62 -0.545772
-4.73 -0.625007
-4.84 -0.704241
-4.95 -0.783476
-5.06 -0.862711
-5.17 -0.941946
-5.28 -1.0212
-5.39 -1.1004
-5.5 -1.1797
-5.61 -1.2589
-5.72 -1.3381
-5.83 -1.4174
-5.94 -1.4966
-6.05 -1.5758
-6.16 -1.6551
-6.27 -1.7343
-6.38 -1.8135
-6.49 -1.8928
-6.6 -1.972
END VI PULL_UP

DATAPOINTS VI pull_down
-3.3 -0.0366014
-3.19 -0.0365243
-3.08 -0.0364472
-2.97 -0.03637
-2.86 -0.0362929
-2.75 -0.0362158
-2.64 -0.0361387
-2.53 -0.0360616
-2.42 -0.0359844
-2.31 -0.0359073
-2.2 -0.0358302
-2.09 -0.0357531
-1.98 -0.035676
-1.87 -0.0355988
-1.76 -0.0355217
-1.65 -0.0354446
-1.54 -0.0353675
-1.43 -0.0352903
-1.32 -0.0352132
-1.21 -0.0351361
-1.1 -0.035059
-0.99 -0.0349819
-0.88 -0.0349047
-0.77 -0.0348276
-0.66 -0.0347505
-0.55 -0.0318758
-0.44 -0.0261343
-0.33 -0.0203928
-0.22 -0.0141819
-0.11 -0.0073758
0 -0.000569628
0.11 0.0062365
0.22 0.0130426
0.33 0.0173922
0.44 0.0214157
0.55 0.0254391
0.66 0.0294626
0.77 0.0332174
0.88 0.0351586
0.99 0.0367205
1.1 0.038044
1.21 0.0393045
1.32 0.0404641
1.43 0.0415684
1.54 0.0426727
1.65 0.0437597
1.76 0.0448086
1.87 0.0458487
1.98 0.0468538
2.09 0.0478309
2.2 0.0487055
2.31 0.0495801
2.42 0.0504548
2.53 0.0512702
2.64 0.0519569
2.75 0.052536
2.86 0.0530196
2.97 0.0579657
3.08 0.0587567
3.19 0.0594693
3.3 0.0601378
3.41 0.0607033
3.52 0.0611829
3.63 0.0615693
3.74 0.0618542
3.85 0.0620981
3.96 0.0622919
4.07 0.0623017
4.18 0.0623115
4.29 0.0623212
4.4 0.062331
4.51 0.0623408
4.62 0.0623506
4.73 0.0623604
4.84 0.0623702
4.95 0.06238
5.06 0.0623897
5.17 0.0623995
5.28 0.0624093
5.39 0.0624191
5.5 0.0624289
5.61 0.0624387
5.72 0.0624484
5.83 0.0624582
5.94 0.062468
6.05 0.0624778
6.16 0.0624876
6.27 0.0624973
6.38 0.0625071
6.49 0.0625169
6.6 0.0625267
END VI pull_down
datapoints tv RisingWaveform name=rise_1 R_fixture=50 V_fixture=3.3 
0 1.2913
1.875e-10 1.2913
2.25e-10 1.2913
2.375e-10 1.2913
2.5e-10 1.2913
2.625e-10 1.2913
2.75e-10 1.2913
2.875e-10 1.2913
3e-10 1.2913
3.125e-10 1.2913
3.25e-10 1.2913
3.375e-10 1.2914
3.5e-10 1.2913
3.625e-10 1.2913
3.75e-10 1.291
3.875e-10 1.2889
4e-10 1.2855
4.125e-10 1.2837
4.25e-10 1.2835
4.375e-10 1.2841
4.5e-10 1.2849
4.625e-10 1.2857
4.75e-10 1.2863
4.875e-10 1.2868
5e-10 1.2872
5.125e-10 1.2873
5.25e-10 1.287
5.375e-10 1.2865
5.5e-10 1.286
5.625e-10 1.2858
5.75e-10 1.286
5.875e-10 1.2864
6e-10 1.287
6.125e-10 1.2877
6.25e-10 1.2886
6.375e-10 1.2896
6.5e-10 1.2911
6.625e-10 1.2933
6.75e-10 1.2966
6.875e-10 1.301
7e-10 1.3063
7.125e-10 1.3117
7.25e-10 1.3169
7.375e-10 1.3215
7.5e-10 1.3254
7.625e-10 1.3286
7.75e-10 1.3314
7.875e-10 1.3335
8e-10 1.3334
8.125e-10 1.3329
8.25e-10 1.3376
8.375e-10 1.3507
8.5e-10 1.3732
8.625e-10 1.4035
8.75e-10 1.4422
8.875e-10 1.4867
9e-10 1.5409
9.125e-10 1.601
9.25e-10 1.669
9.375e-10 1.7491
9.5e-10 1.8293
9.625e-10 1.9219
9.75e-10 2.0243
9.875e-10 2.133
1e-09 2.2416
1.0125e-09 2.3489
1.025e-09 2.449
1.0375e-09 2.5411
1.05e-09 2.6248
1.0625e-09 2.7018
1.075e-09 2.7722
1.0875e-09 2.837
1.1e-09 2.8962
1.1125e-09 2.9499
1.125e-09 2.9983
1.1375e-09 3.0442
1.15e-09 3.0893
1.1625e-09 3.1309
1.175e-09 3.1658
1.1875e-09 3.1922
1.2e-09 3.2138
1.2125e-09 3.231
1.225e-09 3.2452
1.2375e-09 3.2559
1.25e-09 3.2642
1.2625e-09 3.272
1.275e-09 3.2767
1.2875e-09 3.2809
1.3e-09 3.2851
1.3125e-09 3.2887
1.325e-09 3.2902
1.3375e-09 3.2918
1.35e-09 3.2933
1.3625e-09 3.2949
1.375e-09 3.2956
1.3875e-09 3.296
1.4e-09 3.2964
1.4125e-09 3.2969
1.425e-09 3.2973
1.4375e-09 3.2977
1.45e-09 3.2978
1.4625e-09 3.2979
1.475e-09 3.298
1.4875e-09 3.2981
1.5e-09 3.2982
1.5125e-09 3.2983
1.525e-09 3.2984
1.5375e-09 3.2984
1.55e-09 3.2984
1.5625e-09 3.2985
1.575e-09 3.2985
1.5875e-09 3.2986
1.6e-09 3.2986
1.6125e-09 3.2986
1.625e-09 3.2986
1.6375e-09 3.2987
1.65e-09 3.2987
1.6625e-09 3.2987
1.675e-09 3.2988
1.6875e-09 3.2988
1.7e-09 3.2988
1.7125e-09 3.2988
1.725e-09 3.2989
1.7375e-09 3.2989
1.75e-09 3.2989
1.7625e-09 3.2989
1.775e-09 3.299
1.7875e-09 3.299
1.8e-09 3.299
1.8125e-09 3.299
1.825e-09 3.2991
1.8375e-09 3.2991
1.8625e-09 3.2991
1.875e-09 3.2992
1.8875e-09 3.2992
1.9e-09 3.2992
1.9125e-09 3.2993
1.925e-09 3.2993
1.9375e-09 3.2994
1.95e-09 3.2994
1.975e-09 3.2994
1.9875e-09 3.2994
2e-09 3.2994
2.0125e-09 3.2994
2.025e-09 3.2994
2.0375e-09 3.2994
2.05e-09 3.2995
2.0625e-09 3.2995
2.075e-09 3.2995
2.1e-09 3.2995
2.1125e-09 3.2995
2.1375e-09 3.2995
2.15e-09 3.2995
2.175e-09 3.2995
2.1875e-09 3.2996
2.2e-09 3.2996
2.2375e-09 3.2996
2.25e-09 3.2996
2.2875e-09 3.2996
2.325e-09 3.2996
2.3375e-09 3.2996
2.35e-09 3.2996
2.3625e-09 3.2996
2.4125e-09 3.2996
2.4375e-09 3.2996
2.45e-09 3.2997
2.4625e-09 3.2997
2.475e-09 3.2997
2.5375e-09 3.2997
2.6e-09 3.2997
2.6125e-09 3.2997
2.625e-09 3.2997
2.6375e-09 3.2997
2.65e-09 3.2997
2.6625e-09 3.2997
2.6875e-09 3.2997
2.75e-09 3.2997
2.7625e-09 3.2997
2.775e-09 3.2997
2.7875e-09 3.2997
2.8e-09 3.2998
2.8125e-09 3.2998
2.825e-09 3.2998
2.8375e-09 3.2998
2.85e-09 3.2998
2.875e-09 3.2998
2.8875e-09 3.2998
2.925e-09 3.2998
2.9375e-09 3.2998
3.025e-09 3.2998
3.0375e-09 3.2998
3.05e-09 3.2998
3.0875e-09 3.2998
3.1e-09 3.2998
3.2125e-09 3.2998
3.275e-09 3.2998
3.35e-09 3.2998
3.4125e-09 3.2998
3.425e-09 3.2999
3.4875e-09 3.2999
3.5e-09 3.2999
3.55e-09 3.2999
3.8625e-09 3.2999
3.875e-09 3.2999
3.925e-09 3.2999
4.15e-09 3.2999
4.35e-09 3.2999
4.3625e-09 3.2999
4.5375e-09 3.2999
4.55e-09 3.2999
4.5625e-09 3.2999
4.5875e-09 3.2999
4.6e-09 3.2999
5.0125e-09 3.2999
5.35e-09 3.2999
5.7125e-09 3.2999
5.725e-09 3.3
5.7625e-09 3.3
6.0875e-09 3.3
6.1e-09 3.3
6.5125e-09 3.3
6.8375e-09 3.3
7.2625e-09 3.3
7.6e-09 3.3
7.8125e-09 3.3
7.825e-09 3.3
8.025e-09 3.3
9.5125e-09 3.3
9.8375e-09 3.3
1.06e-08 3.3
1.10125e-08 3.3
1.5e-08 3.3
End tv RisingWaveform name=rise_1
datapoints tv RisingWaveform name=rise_2 R_fixture=50 V_fixture=0 
0 0
1.875e-10 0
2.25e-10 0
2.375e-10 0
2.5e-10 0
2.625e-10 0
2.75e-10 0
2.875e-10 -5.04167e-07
3e-10 -2.4451e-06
3.125e-10 -7.77438e-07
3.25e-10 1.26394e-05
3.375e-10 2.01601e-05
3.5e-10 -6.2026e-06
3.625e-10 -6.75184e-05
3.75e-10 -0.000208403
3.875e-10 -0.0019111
4e-10 -0.0042055
4.125e-10 -0.0048097
4.25e-10 -0.0041919
4.375e-10 -0.003168
4.5e-10 -0.0022134
4.625e-10 -0.0014836
4.75e-10 -0.000929047
4.875e-10 -0.000558333
5e-10 -0.00033724
5.125e-10 -0.000340311
5.25e-10 -0.000679251
5.375e-10 -0.000991854
5.5e-10 -0.0011781
5.625e-10 -0.0012
5.75e-10 -0.0011354
5.875e-10 -0.001003
6e-10 -0.000782141
6.125e-10 -0.000480407
6.25e-10 -9.19008e-05
6.375e-10 0.000451263
6.5e-10 0.0012885
6.625e-10 0.0026744
6.75e-10 0.0048404
6.875e-10 0.0076822
7e-10 0.0107545
7.125e-10 0.0136136
7.25e-10 0.0158598
7.375e-10 0.0175138
7.5e-10 0.0186076
7.625e-10 0.0192856
7.75e-10 0.0196355
7.875e-10 0.0201874
8e-10 0.0199428
8.125e-10 0.0190606
8.25e-10 0.0188296
8.375e-10 0.0194994
8.5e-10 0.0211115
8.625e-10 0.0235224
8.75e-10 0.026699
8.875e-10 0.0311691
9e-10 0.0366177
9.125e-10 0.0430892
9.25e-10 0.0520765
9.375e-10 0.0620786
9.5e-10 0.0755769
9.625e-10 0.0890752
9.75e-10 0.102873
9.875e-10 0.122084
1e-09 0.141296
1.0125e-09 0.16098
1.025e-09 0.182985
1.0375e-09 0.20499
1.05e-09 0.226953
1.0625e-09 0.248741
1.075e-09 0.270529
1.0875e-09 0.292317
1.1e-09 0.313914
1.1125e-09 0.335497
1.125e-09 0.357079
1.1375e-09 0.378882
1.15e-09 0.401076
1.175e-09 0.445464
1.1875e-09 0.468668
1.2e-09 0.492803
1.2125e-09 0.516938
1.225e-09 0.541072
1.2375e-09 0.565207
1.25e-09 0.589747
1.2625e-09 0.616574
1.275e-09 0.643401
1.2875e-09 0.670228
1.3e-09 0.697055
1.3125e-09 0.723881
1.325e-09 0.751376
1.3375e-09 0.779882
1.35e-09 0.808455
1.3625e-09 0.837197
1.375e-09 0.866056
1.3875e-09 0.894915
1.4e-09 0.923775
1.4125e-09 0.952784
1.425e-09 0.981905
1.4375e-09 1.011
1.45e-09 1.0402
1.4625e-09 1.0693
1.475e-09 1.0984
1.5e-09 1.156
1.5125e-09 1.1848
1.525e-09 1.2131
1.5375e-09 1.2409
1.55e-09 1.2687
1.5625e-09 1.2965
1.575e-09 1.3233
1.5875e-09 1.3498
1.6e-09 1.3756
1.6125e-09 1.4009
1.625e-09 1.425
1.6375e-09 1.4487
1.65e-09 1.4708
1.6625e-09 1.4918
1.675e-09 1.5116
1.6875e-09 1.5303
1.7e-09 1.5482
1.7125e-09 1.5652
1.725e-09 1.579
1.7375e-09 1.5907
1.75e-09 1.6011
1.7625e-09 1.6109
1.775e-09 1.6197
1.7875e-09 1.628
1.8e-09 1.6354
1.8125e-09 1.6428
1.825e-09 1.6497
1.8375e-09 1.6563
1.85e-09 1.663
1.8625e-09 1.6693
1.875e-09 1.6754
1.9e-09 1.6874
1.9125e-09 1.6931
1.925e-09 1.6985
1.9375e-09 1.7039
1.95e-09 1.7093
1.9625e-09 1.7145
1.975e-09 1.7193
1.9875e-09 1.724
2e-09 1.7288
2.0125e-09 1.7335
2.025e-09 1.7379
2.0375e-09 1.742
2.05e-09 1.7461
2.0625e-09 1.7502
2.075e-09 1.7539
2.0875e-09 1.7576
2.1e-09 1.7612
2.1125e-09 1.7648
2.125e-09 1.7682
2.1375e-09 1.7714
2.15e-09 1.7745
2.1625e-09 1.7776
2.175e-09 1.7803
2.1875e-09 1.7829
2.2e-09 1.7856
2.2125e-09 1.7882
2.225e-09 1.7902
2.2375e-09 1.7912
2.25e-09 1.7923
2.275e-09 1.7943
2.2875e-09 1.7953
2.3e-09 1.7952
2.3125e-09 1.795
2.325e-09 1.7948
2.3375e-09 1.7946
2.35e-09 1.7944
2.3625e-09 1.7942
2.375e-09 1.7947
2.3875e-09 1.7953
2.4e-09 1.7959
2.4125e-09 1.7966
2.425e-09 1.7972
2.4375e-09 1.7986
2.45e-09 1.8001
2.4625e-09 1.8016
2.475e-09 1.803
2.4875e-09 1.8045
2.5e-09 1.806
2.5125e-09 1.8076
2.525e-09 1.8093
2.55e-09 1.8127
2.5625e-09 1.8143
2.575e-09 1.816
2.5875e-09 1.8177
2.6e-09 1.8193
2.6125e-09 1.821
2.625e-09 1.8227
2.6375e-09 1.8244
2.65e-09 1.826
2.6625e-09 1.8277
2.675e-09 1.8293
2.6875e-09 1.8308
2.7e-09 1.8324
2.7125e-09 1.8339
2.725e-09 1.8354
2.7375e-09 1.8369
2.75e-09 1.8383
2.7625e-09 1.8398
2.775e-09 1.8413
2.7875e-09 1.8427
2.8e-09 1.8442
2.8125e-09 1.8456
2.825e-09 1.847
2.8375e-09 1.8483
2.85e-09 1.8496
2.8625e-09 1.8509
2.875e-09 1.8521
2.8875e-09 1.8534
2.9e-09 1.8547
2.9125e-09 1.856
2.925e-09 1.8573
2.9375e-09 1.8586
2.95e-09 1.8599
2.9625e-09 1.8612
2.975e-09 1.8625
2.9875e-09 1.8637
3e-09 1.8647
3.0125e-09 1.8658
3.025e-09 1.8668
3.0375e-09 1.8679
3.05e-09 1.869
3.0625e-09 1.87
3.075e-09 1.8711
3.0875e-09 1.8721
3.1e-09 1.8732
3.1125e-09 1.8742
3.125e-09 1.8753
3.1375e-09 1.8763
3.15e-09 1.8774
3.1625e-09 1.8784
3.175e-09 1.8795
3.1875e-09 1.8805
3.2e-09 1.8816
3.2125e-09 1.8826
3.225e-09 1.8837
3.2375e-09 1.8846
3.25e-09 1.8853
3.2625e-09 1.8861
3.275e-09 1.8868
3.2875e-09 1.8876
3.3e-09 1.8883
3.3125e-09 1.889
3.325e-09 1.8898
3.3375e-09 1.8905
3.35e-09 1.8913
3.3625e-09 1.892
3.375e-09 1.8928
3.3875e-09 1.8935
3.4e-09 1.8943
3.4125e-09 1.895
3.425e-09 1.8958
3.4375e-09 1.8965
3.45e-09 1.8973
3.4625e-09 1.898
3.475e-09 1.8987
3.4875e-09 1.8995
3.5e-09 1.9002
3.5125e-09 1.901
3.525e-09 1.9017
3.5375e-09 1.9025
3.55e-09 1.9032
3.5625e-09 1.904
3.575e-09 1.9047
3.5875e-09 1.9055
3.6e-09 1.9062
3.6125e-09 1.907
3.625e-09 1.9077
3.6375e-09 1.9084
3.65e-09 1.9092
3.6625e-09 1.9099
3.675e-09 1.9107
3.6875e-09 1.9114
3.7e-09 1.9122
3.7125e-09 1.9129
3.725e-09 1.9137
3.7375e-09 1.9144
3.75e-09 1.915
3.7625e-09 1.9155
3.775e-09 1.9161
3.7875e-09 1.9166
3.8e-09 1.9171
3.825e-09 1.9181
3.8375e-09 1.9186
3.85e-09 1.9191
3.9e-09 1.9211
3.9125e-09 1.9216
3.95e-09 1.9231
3.9625e-09 1.9236
3.975e-09 1.9242
3.9875e-09 1.9247
4e-09 1.9252
4.025e-09 1.9262
4.0375e-09 1.9267
4.05e-09 1.9271
4.0625e-09 1.9274
4.075e-09 1.9278
4.0875e-09 1.9281
4.1e-09 1.9285
4.1125e-09 1.9288
4.125e-09 1.9292
4.1375e-09 1.9295
4.15e-09 1.9299
4.1625e-09 1.9303
4.175e-09 1.9306
4.1875e-09 1.931
4.2e-09 1.9313
4.2125e-09 1.9317
4.225e-09 1.932
4.2375e-09 1.9324
4.25e-09 1.9327
4.2625e-09 1.9331
4.275e-09 1.9334
4.2875e-09 1.9338
4.3e-09 1.9341
4.3125e-09 1.9345
4.325e-09 1.9348
4.3375e-09 1.9352
4.35e-09 1.9356
4.3625e-09 1.9359
4.375e-09 1.9363
4.3875e-09 1.9366
4.4e-09 1.937
4.4125e-09 1.9373
4.425e-09 1.9377
4.4375e-09 1.938
4.45e-09 1.9384
4.4625e-09 1.9387
4.475e-09 1.9391
4.4875e-09 1.9394
4.5e-09 1.9398
4.5125e-09 1.9401
4.525e-09 1.9405
4.5375e-09 1.9409
4.55e-09 1.9412
4.5625e-09 1.9416
4.575e-09 1.9419
4.5875e-09 1.9423
4.6e-09 1.9426
4.6125e-09 1.943
4.625e-09 1.9433
4.6375e-09 1.9437
4.65e-09 1.944
4.6625e-09 1.9444
4.675e-09 1.9447
4.6875e-09 1.945
4.7e-09 1.9452
4.7125e-09 1.9455
4.7375e-09 1.9459
4.75e-09 1.9461
4.7625e-09 1.9464
4.7875e-09 1.9468
4.8e-09 1.947
4.8125e-09 1.9473
4.8375e-09 1.9477
4.85e-09 1.9479
4.8625e-09 1.9482
4.875e-09 1.9484
4.8875e-09 1.9486
4.9e-09 1.9488
4.9125e-09 1.9491
4.925e-09 1.9493
4.9375e-09 1.9495
4.95e-09 1.9497
4.9625e-09 1.95
4.975e-09 1.9502
5e-09 1.9506
5.0125e-09 1.9509
5.025e-09 1.9511
5.05e-09 1.9515
5.0625e-09 1.9518
5.1e-09 1.9524
5.1125e-09 1.9527
5.1375e-09 1.9531
5.15e-09 1.9533
5.1625e-09 1.9536
5.175e-09 1.9538
5.1875e-09 1.954
5.2e-09 1.9541
5.2125e-09 1.9543
5.225e-09 1.9544
5.2375e-09 1.9546
5.25e-09 1.9547
5.2625e-09 1.9549
5.275e-09 1.955
5.2875e-09 1.9552
5.3e-09 1.9553
5.3125e-09 1.9555
5.325e-09 1.9556
5.3375e-09 1.9558
5.35e-09 1.9559
5.3625e-09 1.9561
5.375e-09 1.9562
5.3875e-09 1.9564
5.4e-09 1.9565
5.4125e-09 1.9567
5.425e-09 1.9568
5.4375e-09 1.957
5.45e-09 1.9571
5.4625e-09 1.9573
5.475e-09 1.9574
5.4875e-09 1.9576
5.5e-09 1.9577
5.5125e-09 1.9579
5.525e-09 1.958
5.5375e-09 1.9582
5.55e-09 1.9583
5.5625e-09 1.9585
5.575e-09 1.9586
5.5875e-09 1.9588
5.6e-09 1.9589
5.6125e-09 1.9591
5.625e-09 1.9592
5.6375e-09 1.9594
5.65e-09 1.9595
5.6625e-09 1.9597
5.675e-09 1.9598
5.6875e-09 1.96
5.7e-09 1.9601
5.7125e-09 1.9603
5.725e-09 1.9604
5.7375e-09 1.9606
5.75e-09 1.9607
5.7625e-09 1.9609
5.775e-09 1.961
5.7875e-09 1.9612
5.8e-09 1.9613
5.8125e-09 1.9615
5.825e-09 1.9616
5.8375e-09 1.9618
5.85e-09 1.9619
5.8625e-09 1.9621
5.875e-09 1.9622
5.8875e-09 1.9624
5.9e-09 1.9625
5.9125e-09 1.9627
5.925e-09 1.9628
5.9375e-09 1.9629
5.95e-09 1.963
5.9625e-09 1.9631
5.975e-09 1.9632
5.9875e-09 1.9633
6e-09 1.9634
6.0125e-09 1.9635
6.025e-09 1.9636
6.0375e-09 1.9637
6.05e-09 1.9638
6.075e-09 1.964
6.0875e-09 1.964
6.1e-09 1.9641
6.1125e-09 1.9642
6.125e-09 1.9643
6.1375e-09 1.9644
6.15e-09 1.9645
6.1625e-09 1.9646
6.175e-09 1.9647
6.2e-09 1.9649
6.2125e-09 1.965
6.225e-09 1.9651
6.2375e-09 1.9652
6.25e-09 1.9653
6.2625e-09 1.9654
6.275e-09 1.9655
6.2875e-09 1.9655
6.3e-09 1.9656
6.3125e-09 1.9657
6.325e-09 1.9658
6.35e-09 1.966
6.3625e-09 1.9661
6.375e-09 1.9662
6.3875e-09 1.9663
6.4125e-09 1.9665
6.425e-09 1.9666
6.4375e-09 1.9667
6.45e-09 1.9668
6.4625e-09 1.9669
6.475e-09 1.9669
6.5e-09 1.9671
6.5125e-09 1.9672
6.525e-09 1.9673
6.5375e-09 1.9674
6.55e-09 1.9675
6.5625e-09 1.9676
6.5875e-09 1.9678
6.6e-09 1.9679
6.625e-09 1.9681
6.6375e-09 1.9682
6.65e-09 1.9683
6.6625e-09 1.9683
6.675e-09 1.9684
6.6875e-09 1.9685
6.7e-09 1.9686
6.7125e-09 1.9686
6.725e-09 1.9687
6.7375e-09 1.9687
6.75e-09 1.9688
6.7625e-09 1.9689
6.775e-09 1.9689
6.7875e-09 1.969
6.8e-09 1.9691
6.8125e-09 1.9691
6.825e-09 1.9692
6.8375e-09 1.9692
6.85e-09 1.9693
6.8625e-09 1.9694
6.875e-09 1.9694
6.8875e-09 1.9695
6.9e-09 1.9695
6.9125e-09 1.9696
6.925e-09 1.9697
6.9375e-09 1.9697
6.95e-09 1.9698
6.9625e-09 1.9698
6.975e-09 1.9699
6.9875e-09 1.97
7e-09 1.97
7.0125e-09 1.9701
7.025e-09 1.9701
7.0375e-09 1.9702
7.05e-09 1.9703
7.0625e-09 1.9703
7.075e-09 1.9704
7.0875e-09 1.9704
7.1e-09 1.9705
7.1125e-09 1.9706
7.125e-09 1.9706
7.1375e-09 1.9707
7.15e-09 1.9708
7.1625e-09 1.9708
7.175e-09 1.9709
7.1875e-09 1.9709
7.2e-09 1.971
7.2125e-09 1.9711
7.225e-09 1.9711
7.2375e-09 1.9712
7.25e-09 1.9712
7.2625e-09 1.9713
7.275e-09 1.9714
7.2875e-09 1.9714
7.3e-09 1.9715
7.3125e-09 1.9715
7.325e-09 1.9716
7.3375e-09 1.9717
7.35e-09 1.9717
7.3625e-09 1.9718
7.375e-09 1.9718
7.3875e-09 1.9719
7.4e-09 1.972
7.4125e-09 1.972
7.425e-09 1.9721
7.4375e-09 1.9721
7.45e-09 1.9722
7.4625e-09 1.9722
7.475e-09 1.9723
7.5e-09 1.9723
7.5125e-09 1.9724
7.525e-09 1.9724
7.5375e-09 1.9725
7.5625e-09 1.9725
7.575e-09 1.9726
7.5875e-09 1.9726
7.6e-09 1.9727
7.625e-09 1.9727
7.6375e-09 1.9728
7.65e-09 1.9728
7.6625e-09 1.9729
7.6875e-09 1.9729
7.7e-09 1.973
7.7125e-09 1.973
7.725e-09 1.9731
7.7375e-09 1.9731
7.75e-09 1.9731
7.7625e-09 1.9732
7.775e-09 1.9732
7.7875e-09 1.9733
7.8e-09 1.9733
7.8125e-09 1.9733
7.825e-09 1.9734
7.8375e-09 1.9734
7.85e-09 1.9735
7.875e-09 1.9735
7.8875e-09 1.9736
7.9e-09 1.9736
7.9125e-09 1.9737
7.9375e-09 1.9737
7.95e-09 1.9738
7.9625e-09 1.9738
7.975e-09 1.9739
8e-09 1.9739
8.0125e-09 1.974
8.025e-09 1.974
8.0375e-09 1.9741
8.0625e-09 1.9741
8.075e-09 1.9742
8.0875e-09 1.9742
8.1e-09 1.9743
8.125e-09 1.9743
8.1375e-09 1.9744
8.15e-09 1.9744
8.1625e-09 1.9745
8.175e-09 1.9745
8.1875e-09 1.9745
8.2e-09 1.9746
8.2125e-09 1.9746
8.2375e-09 1.9746
8.25e-09 1.9747
8.2625e-09 1.9747
8.275e-09 1.9747
8.2875e-09 1.9748
8.3e-09 1.9748
8.325e-09 1.9748
8.3375e-09 1.9749
8.35e-09 1.9749
8.3625e-09 1.9749
8.375e-09 1.9749
8.3875e-09 1.975
8.4125e-09 1.975
8.425e-09 1.9751
8.4375e-09 1.9751
8.45e-09 1.9751
8.4625e-09 1.9751
8.475e-09 1.9752
8.5e-09 1.9752
8.5125e-09 1.9752
8.525e-09 1.9753
8.5375e-09 1.9753
8.55e-09 1.9753
8.5625e-09 1.9754
8.5875e-09 1.9754
8.6e-09 1.9754
8.6125e-09 1.9755
8.625e-09 1.9755
8.6375e-09 1.9755
8.65e-09 1.9755
8.6625e-09 1.9756
8.675e-09 1.9756
8.6875e-09 1.9756
8.7e-09 1.9757
8.7125e-09 1.9757
8.725e-09 1.9757
8.7375e-09 1.9757
8.75e-09 1.9758
8.7625e-09 1.9758
8.7875e-09 1.9758
8.8e-09 1.9759
8.8125e-09 1.9759
8.825e-09 1.9759
8.8375e-09 1.976
8.85e-09 1.976
8.875e-09 1.976
8.8875e-09 1.9761
8.9125e-09 1.9761
8.925e-09 1.9761
8.9375e-09 1.9762
8.95e-09 1.9762
8.9625e-09 1.9762
8.975e-09 1.9762
8.9875e-09 1.9762
9e-09 1.9763
9.0125e-09 1.9763
9.025e-09 1.9763
9.0375e-09 1.9763
9.05e-09 1.9763
9.0625e-09 1.9764
9.075e-09 1.9764
9.0875e-09 1.9764
9.1e-09 1.9764
9.1125e-09 1.9764
9.125e-09 1.9764
9.1375e-09 1.9765
9.15e-09 1.9765
9.1625e-09 1.9765
9.175e-09 1.9765
9.1875e-09 1.9765
9.2e-09 1.9766
9.2125e-09 1.9766
9.225e-09 1.9766
9.2375e-09 1.9766
9.25e-09 1.9766
9.2625e-09 1.9767
9.275e-09 1.9767
9.2875e-09 1.9767
9.3e-09 1.9767
9.3125e-09 1.9767
9.325e-09 1.9767
9.3375e-09 1.9768
9.3625e-09 1.9768
9.375e-09 1.9768
9.3875e-09 1.9768
9.4e-09 1.9769
9.4125e-09 1.9769
9.425e-09 1.9769
9.4375e-09 1.9769
9.45e-09 1.9769
9.4625e-09 1.977
9.475e-09 1.977
9.4875e-09 1.977
9.5e-09 1.977
9.5125e-09 1.977
9.525e-09 1.977
9.5375e-09 1.9771
9.55e-09 1.9771
9.575e-09 1.9771
9.5875e-09 1.9771
9.6e-09 1.9772
9.6125e-09 1.9772
9.625e-09 1.9772
9.6375e-09 1.9772
9.65e-09 1.9772
9.6625e-09 1.9773
9.675e-09 1.9773
9.6875e-09 1.9773
9.7e-09 1.9773
9.7125e-09 1.9773
9.7375e-09 1.9773
9.75e-09 1.9774
9.7625e-09 1.9774
9.775e-09 1.9774
9.8e-09 1.9774
9.8125e-09 1.9774
9.825e-09 1.9774
9.8375e-09 1.9774
9.85e-09 1.9775
9.8625e-09 1.9775
9.875e-09 1.9775
9.8875e-09 1.9775
9.9e-09 1.9775
9.925e-09 1.9775
9.9375e-09 1.9775
9.95e-09 1.9776
9.9625e-09 1.9776
9.9875e-09 1.9776
1e-08 1.9776
1.00125e-08 1.9776
1.0025e-08 1.9776
1.00375e-08 1.9777
1.005e-08 1.9777
1.0075e-08 1.9777
1.00875e-08 1.9777
1.01e-08 1.9777
1.01125e-08 1.9777
1.0125e-08 1.9777
1.01375e-08 1.9778
1.015e-08 1.9778
1.01625e-08 1.9778
1.0175e-08 1.9778
1.02e-08 1.9778
1.02125e-08 1.9778
1.0225e-08 1.9778
1.02375e-08 1.9779
1.025e-08 1.9779
1.02625e-08 1.9779
1.0275e-08 1.9779
1.02875e-08 1.9779
1.03e-08 1.9779
1.03125e-08 1.9779
1.0325e-08 1.978
1.03375e-08 1.978
1.035e-08 1.978
1.03625e-08 1.978
1.03875e-08 1.978
1.04e-08 1.978
1.04125e-08 1.978
1.0425e-08 1.9781
1.04375e-08 1.9781
1.04625e-08 1.9781
1.0475e-08 1.9781
1.05e-08 1.9781
1.05125e-08 1.9781
1.05375e-08 1.9781
1.055e-08 1.9781
1.05625e-08 1.9782
1.05875e-08 1.9782
1.06e-08 1.9782
1.0625e-08 1.9782
1.06375e-08 1.9782
1.06625e-08 1.9782
1.0675e-08 1.9782
1.06875e-08 1.9782
1.07e-08 1.9783
1.07125e-08 1.9783
1.07375e-08 1.9783
1.075e-08 1.9783
1.0775e-08 1.9783
1.07875e-08 1.9783
1.0825e-08 1.9783
1.08375e-08 1.9784
1.085e-08 1.9784
1.08625e-08 1.9784
1.0875e-08 1.9784
1.09e-08 1.9784
1.09125e-08 1.9784
1.09375e-08 1.9784
1.095e-08 1.9784
1.09625e-08 1.9784
1.0975e-08 1.9785
1.09875e-08 1.9785
1.1025e-08 1.9785
1.10375e-08 1.9785
1.10625e-08 1.9785
1.1075e-08 1.9785
1.11e-08 1.9785
1.11125e-08 1.9786
1.11375e-08 1.9786
1.115e-08 1.9786
1.11625e-08 1.9786
1.11875e-08 1.9786
1.12e-08 1.9786
1.1225e-08 1.9786
1.12375e-08 1.9786
1.125e-08 1.9786
1.12625e-08 1.9786
1.1275e-08 1.9787
1.13e-08 1.9787
1.13125e-08 1.9787
1.135e-08 1.9787
1.13625e-08 1.9787
1.14e-08 1.9787
1.14125e-08 1.9787
1.145e-08 1.9787
1.14625e-08 1.9788
1.15e-08 1.9788
1.15125e-08 1.9788
1.155e-08 1.9788
1.15625e-08 1.9788
1.16e-08 1.9788
1.16125e-08 1.9788
1.165e-08 1.9788
1.16625e-08 1.9789
1.17e-08 1.9789
1.17125e-08 1.9789
1.1725e-08 1.9789
1.175e-08 1.9789
1.17625e-08 1.9789
1.18e-08 1.9789
1.18125e-08 1.9789
1.18375e-08 1.9789
1.185e-08 1.979
1.18625e-08 1.979
1.19125e-08 1.979
1.1925e-08 1.979
1.1975e-08 1.979
1.19875e-08 1.979
1.20125e-08 1.979
1.20375e-08 1.979
1.205e-08 1.979
1.20875e-08 1.979
1.21e-08 1.9791
1.21125e-08 1.9791
1.2125e-08 1.9791
1.2175e-08 1.9791
1.21875e-08 1.9791
1.22375e-08 1.9791
1.225e-08 1.9791
1.23e-08 1.9791
1.23125e-08 1.9791
1.23625e-08 1.9791
1.2375e-08 1.9792
1.23875e-08 1.9792
1.24e-08 1.9792
1.24375e-08 1.9792
1.245e-08 1.9792
1.25e-08 1.9792
1.25125e-08 1.9792
1.25625e-08 1.9792
1.2575e-08 1.9792
1.2625e-08 1.9792
1.26375e-08 1.9792
1.265e-08 1.9793
1.27125e-08 1.9793
1.2725e-08 1.9793
1.27875e-08 1.9793
1.28e-08 1.9793
1.2875e-08 1.9793
1.28875e-08 1.9793
1.295e-08 1.9793
1.29625e-08 1.9793
1.30125e-08 1.9793
1.3025e-08 1.9794
1.30375e-08 1.9794
1.305e-08 1.9794
1.3125e-08 1.9794
1.31375e-08 1.9794
1.32e-08 1.9794
1.32125e-08 1.9794
1.32875e-08 1.9794
1.33e-08 1.9794
1.33625e-08 1.9794
1.3375e-08 1.9794
1.33875e-08 1.9794
1.34e-08 1.9794
1.34125e-08 1.9795
1.345e-08 1.9795
1.34625e-08 1.9795
1.3475e-08 1.9795
1.3575e-08 1.9795
1.35875e-08 1.9795
1.3675e-08 1.9795
1.36875e-08 1.9795
1.3775e-08 1.9795
1.37875e-08 1.9795
1.38875e-08 1.9795
1.39e-08 1.9795
1.39375e-08 1.9795
1.395e-08 1.9796
1.39875e-08 1.9796
1.4e-08 1.9796
1.40875e-08 1.9796
1.41e-08 1.9796
1.41375e-08 1.9796
1.42125e-08 1.9796
1.4225e-08 1.9796
1.43375e-08 1.9796
1.435e-08 1.9796
1.4475e-08 1.9796
1.44875e-08 1.9796
1.46e-08 1.9796
1.46125e-08 1.9796
1.4625e-08 1.9797
1.47375e-08 1.9797
1.475e-08 1.9797
1.48625e-08 1.9797
1.4875e-08 1.9797
1.5e-08 1.9797
End tv RisingWaveform name=rise_2
datapoints tv FallingWaveform name=fall_1 R_fixture=50 V_fixture=3.3 
0 3.3
2.125e-10 3.3
2.375e-10 3.3
2.5e-10 3.3
2.625e-10 3.3
2.75e-10 3.3
2.875e-10 3.3
3e-10 3.3
3.125e-10 3.3
3.25e-10 3.3
3.375e-10 3.3
3.5e-10 3.3
3.625e-10 3.3
3.75e-10 3.2999
3.875e-10 3.2998
4e-10 3.2998
4.125e-10 3.2999
4.25e-10 3.2998
4.375e-10 3.2997
4.5e-10 3.2997
4.625e-10 3.2998
4.75e-10 3.3
4.875e-10 3.3001
5e-10 3.3007
5.125e-10 3.3018
5.25e-10 3.3032
5.375e-10 3.3045
5.5e-10 3.3052
5.625e-10 3.3053
5.75e-10 3.3048
5.875e-10 3.3039
6e-10 3.3031
6.125e-10 3.3026
6.25e-10 3.3021
6.375e-10 3.3015
6.5e-10 3.3007
6.625e-10 3.2998
6.75e-10 3.299
6.875e-10 3.2984
7e-10 3.2979
7.125e-10 3.2977
7.25e-10 3.2977
7.375e-10 3.2978
7.5e-10 3.2981
7.625e-10 3.2985
7.75e-10 3.2989
7.875e-10 3.2994
8e-10 3.2999
8.125e-10 3.3004
8.25e-10 3.3008
8.375e-10 3.301
8.5e-10 3.3012
8.625e-10 3.3013
8.75e-10 3.3014
8.875e-10 3.3016
9e-10 3.3018
9.125e-10 3.3022
9.25e-10 3.3025
9.375e-10 3.302
9.5e-10 3.3006
9.625e-10 3.2982
9.75e-10 3.2948
9.875e-10 3.2902
1e-09 3.284
1.0125e-09 3.2761
1.025e-09 3.2674
1.0375e-09 3.2579
1.05e-09 3.2479
1.0625e-09 3.2375
1.075e-09 3.2266
1.0875e-09 3.2153
1.1e-09 3.2039
1.1125e-09 3.1918
1.125e-09 3.1786
1.1375e-09 3.1654
1.15e-09 3.1523
1.1625e-09 3.1375
1.175e-09 3.1208
1.1875e-09 3.1041
1.2e-09 3.0874
1.2125e-09 3.0707
1.225e-09 3.054
1.2375e-09 3.035
1.25e-09 3.0132
1.2625e-09 2.9914
1.275e-09 2.9696
1.2875e-09 2.9478
1.3e-09 2.926
1.3125e-09 2.9041
1.325e-09 2.8823
1.3375e-09 2.8605
1.35e-09 2.8387
1.3625e-09 2.814
1.375e-09 2.7884
1.3875e-09 2.7628
1.4e-09 2.7372
1.4125e-09 2.7116
1.425e-09 2.686
1.4375e-09 2.6598
1.45e-09 2.633
1.4625e-09 2.6061
1.475e-09 2.5793
1.4875e-09 2.5525
1.5e-09 2.5256
1.5125e-09 2.4989
1.525e-09 2.4723
1.5375e-09 2.4457
1.55e-09 2.419
1.5625e-09 2.3924
1.5875e-09 2.3392
1.6e-09 2.3136
1.6125e-09 2.288
1.625e-09 2.2627
1.6375e-09 2.2376
1.65e-09 2.2127
1.6625e-09 2.1887
1.675e-09 2.1646
1.6875e-09 2.1406
1.7e-09 2.1167
1.7125e-09 2.095
1.725e-09 2.0733
1.7375e-09 2.0516
1.75e-09 2.0299
1.7625e-09 2.0082
1.775e-09 1.9865
1.7875e-09 1.967
1.8e-09 1.9487
1.8125e-09 1.9304
1.825e-09 1.9121
1.8375e-09 1.8938
1.85e-09 1.8764
1.8625e-09 1.863
1.875e-09 1.8497
1.8875e-09 1.8363
1.9e-09 1.823
1.9125e-09 1.8096
1.925e-09 1.7963
1.9375e-09 1.7832
1.95e-09 1.7746
1.9625e-09 1.766
1.975e-09 1.7574
1.9875e-09 1.7488
2e-09 1.7402
2.0125e-09 1.7316
2.025e-09 1.7231
2.0375e-09 1.7153
2.05e-09 1.708
2.075e-09 1.6936
2.0875e-09 1.6864
2.1e-09 1.6791
2.1125e-09 1.6719
2.125e-09 1.665
2.1375e-09 1.6582
2.15e-09 1.6515
2.1625e-09 1.6448
2.175e-09 1.638
2.1875e-09 1.6313
2.2e-09 1.6246
2.2125e-09 1.6178
2.225e-09 1.612
2.2375e-09 1.6064
2.25e-09 1.6008
2.2625e-09 1.5953
2.275e-09 1.5897
2.2875e-09 1.5841
2.3e-09 1.5785
2.3125e-09 1.5734
2.325e-09 1.5684
2.3375e-09 1.5636
2.35e-09 1.5589
2.3625e-09 1.5541
2.375e-09 1.5495
2.3875e-09 1.5452
2.4e-09 1.5408
2.4125e-09 1.5365
2.425e-09 1.5322
2.4375e-09 1.5279
2.45e-09 1.5239
2.4625e-09 1.52
2.475e-09 1.516
2.4875e-09 1.5121
2.5e-09 1.5083
2.5125e-09 1.5046
2.525e-09 1.501
2.5375e-09 1.4974
2.55e-09 1.4939
2.5625e-09 1.4905
2.575e-09 1.4871
2.5875e-09 1.4838
2.6e-09 1.4805
2.6125e-09 1.4772
2.625e-09 1.4739
2.6375e-09 1.4706
2.65e-09 1.4672
2.6625e-09 1.4638
2.675e-09 1.4608
2.6875e-09 1.4584
2.7e-09 1.4563
2.7125e-09 1.4544
2.725e-09 1.4526
2.7375e-09 1.4507
2.75e-09 1.4488
2.7625e-09 1.4468
2.775e-09 1.4447
2.8e-09 1.4405
2.8125e-09 1.4384
2.825e-09 1.4363
2.8375e-09 1.4342
2.85e-09 1.4322
2.8625e-09 1.4301
2.875e-09 1.4281
2.8875e-09 1.426
2.9e-09 1.4239
2.9125e-09 1.4219
2.925e-09 1.42
2.9375e-09 1.4181
2.95e-09 1.4163
2.9625e-09 1.4144
2.975e-09 1.4126
2.9875e-09 1.4107
3e-09 1.4089
3.0125e-09 1.407
3.025e-09 1.4052
3.0375e-09 1.4033
3.05e-09 1.4015
3.0625e-09 1.3996
3.075e-09 1.3978
3.0875e-09 1.3963
3.1e-09 1.3949
3.1125e-09 1.3936
3.1375e-09 1.3908
3.15e-09 1.3894
3.1625e-09 1.3881
3.175e-09 1.3867
3.1875e-09 1.3853
3.2e-09 1.3839
3.2125e-09 1.3826
3.2375e-09 1.3798
3.25e-09 1.3785
3.2875e-09 1.3743
3.3e-09 1.373
3.325e-09 1.3702
3.3375e-09 1.3688
3.35e-09 1.3675
3.3875e-09 1.3633
3.4e-09 1.362
3.4125e-09 1.3606
3.425e-09 1.3593
3.45e-09 1.3575
3.4625e-09 1.3567
3.475e-09 1.3558
3.4875e-09 1.355
3.5e-09 1.3541
3.5125e-09 1.3532
3.525e-09 1.3524
3.5375e-09 1.3515
3.55e-09 1.3506
3.5625e-09 1.3498
3.575e-09 1.3489
3.5875e-09 1.348
3.6e-09 1.3472
3.6125e-09 1.3463
3.625e-09 1.3454
3.6375e-09 1.3446
3.65e-09 1.3437
3.6625e-09 1.3429
3.675e-09 1.342
3.6875e-09 1.3411
3.7e-09 1.3403
3.7125e-09 1.3394
3.725e-09 1.3385
3.7375e-09 1.3377
3.75e-09 1.3368
3.7625e-09 1.3359
3.775e-09 1.3351
3.7875e-09 1.3343
3.8e-09 1.3338
3.8125e-09 1.3334
3.8375e-09 1.3324
3.85e-09 1.3319
3.8625e-09 1.3314
3.875e-09 1.3309
3.8875e-09 1.3305
3.9e-09 1.33
3.9125e-09 1.3295
3.925e-09 1.329
3.9375e-09 1.3285
3.95e-09 1.328
3.9625e-09 1.3275
3.975e-09 1.3271
3.9875e-09 1.3266
4.025e-09 1.3251
4.0375e-09 1.3246
4.05e-09 1.3242
4.0625e-09 1.3237
4.075e-09 1.3232
4.0875e-09 1.3227
4.125e-09 1.3212
4.1375e-09 1.3208
4.175e-09 1.3193
4.1875e-09 1.3188
4.2e-09 1.3183
4.2125e-09 1.3179
4.225e-09 1.3174
4.2375e-09 1.3169
4.25e-09 1.3164
4.2625e-09 1.3159
4.275e-09 1.3154
4.2875e-09 1.315
4.3e-09 1.3145
4.3125e-09 1.314
4.325e-09 1.3135
4.3375e-09 1.313
4.35e-09 1.3125
4.3625e-09 1.312
4.375e-09 1.3116
4.3875e-09 1.3112
4.4e-09 1.311
4.4125e-09 1.3107
4.425e-09 1.3105
4.4375e-09 1.3103
4.45e-09 1.3101
4.4625e-09 1.3098
4.475e-09 1.3096
4.4875e-09 1.3094
4.5e-09 1.3091
4.5125e-09 1.3089
4.525e-09 1.3087
4.5375e-09 1.3085
4.55e-09 1.3082
4.5625e-09 1.308
4.575e-09 1.3078
4.5875e-09 1.3075
4.6e-09 1.3073
4.6125e-09 1.3071
4.625e-09 1.3068
4.6375e-09 1.3066
4.65e-09 1.3064
4.6625e-09 1.3062
4.675e-09 1.3059
4.6875e-09 1.3057
4.7e-09 1.3055
4.7125e-09 1.3052
4.7375e-09 1.3048
4.75e-09 1.3045
4.7625e-09 1.3043
4.775e-09 1.3041
4.7875e-09 1.3039
4.8e-09 1.3036
4.825e-09 1.3032
4.8375e-09 1.3029
4.85e-09 1.3027
4.8625e-09 1.3025
4.875e-09 1.3023
4.8875e-09 1.302
4.9e-09 1.3018
4.9125e-09 1.3016
4.925e-09 1.3014
4.9375e-09 1.3013
4.95e-09 1.3012
4.9625e-09 1.301
4.975e-09 1.3009
5e-09 1.3007
5.0125e-09 1.3006
5.025e-09 1.3004
5.0375e-09 1.3003
5.05e-09 1.3002
5.0625e-09 1.3001
5.075e-09 1.3
5.0875e-09 1.2998
5.1e-09 1.2997
5.1125e-09 1.2996
5.125e-09 1.2995
5.1375e-09 1.2993
5.15e-09 1.2992
5.1625e-09 1.2991
5.175e-09 1.299
5.1875e-09 1.2989
5.2e-09 1.2987
5.2125e-09 1.2986
5.225e-09 1.2985
5.25e-09 1.2983
5.2625e-09 1.2981
5.275e-09 1.298
5.2875e-09 1.2979
5.3e-09 1.2978
5.3125e-09 1.2977
5.325e-09 1.2975
5.3375e-09 1.2974
5.35e-09 1.2973
5.3625e-09 1.2972
5.375e-09 1.2971
5.3875e-09 1.2969
5.4e-09 1.2968
5.4125e-09 1.2967
5.425e-09 1.2966
5.4375e-09 1.2966
5.45e-09 1.2965
5.4625e-09 1.2965
5.475e-09 1.2964
5.4875e-09 1.2963
5.5e-09 1.2963
5.5125e-09 1.2962
5.525e-09 1.2962
5.5375e-09 1.2961
5.55e-09 1.296
5.5625e-09 1.296
5.575e-09 1.2959
5.5875e-09 1.2959
5.6e-09 1.2958
5.6125e-09 1.2957
5.625e-09 1.2957
5.6375e-09 1.2956
5.65e-09 1.2956
5.6625e-09 1.2955
5.675e-09 1.2954
5.6875e-09 1.2954
5.7e-09 1.2953
5.7125e-09 1.2953
5.725e-09 1.2952
5.7375e-09 1.2952
5.7625e-09 1.295
5.775e-09 1.295
5.7875e-09 1.2949
5.8e-09 1.2949
5.825e-09 1.2947
5.8375e-09 1.2947
5.85e-09 1.2946
5.8625e-09 1.2946
5.875e-09 1.2945
5.8875e-09 1.2944
5.9e-09 1.2944
5.9125e-09 1.2943
5.925e-09 1.2943
5.95e-09 1.2941
5.9625e-09 1.2941
5.975e-09 1.294
5.9875e-09 1.294
6e-09 1.2939
6.0125e-09 1.2938
6.025e-09 1.2938
6.0375e-09 1.2938
6.05e-09 1.2937
6.075e-09 1.2937
6.0875e-09 1.2936
6.1e-09 1.2936
6.1125e-09 1.2936
6.125e-09 1.2936
6.1375e-09 1.2935
6.15e-09 1.2935
6.1625e-09 1.2935
6.175e-09 1.2934
6.1875e-09 1.2934
6.2e-09 1.2934
6.2125e-09 1.2934
6.225e-09 1.2933
6.2375e-09 1.2933
6.25e-09 1.2933
6.2625e-09 1.2933
6.275e-09 1.2932
6.2875e-09 1.2932
6.3e-09 1.2932
6.3125e-09 1.2931
6.325e-09 1.2931
6.35e-09 1.2931
6.3625e-09 1.293
6.375e-09 1.293
6.3875e-09 1.293
6.4e-09 1.2929
6.4125e-09 1.2929
6.425e-09 1.2929
6.4375e-09 1.2929
6.45e-09 1.2928
6.4625e-09 1.2928
6.475e-09 1.2928
6.4875e-09 1.2927
6.5e-09 1.2927
6.5125e-09 1.2927
6.525e-09 1.2927
6.5375e-09 1.2926
6.5625e-09 1.2926
6.575e-09 1.2926
6.5875e-09 1.2926
6.625e-09 1.2926
6.6375e-09 1.2925
6.7125e-09 1.2925
6.725e-09 1.2924
6.7875e-09 1.2924
6.8e-09 1.2924
6.8125e-09 1.2924
6.825e-09 1.2923
6.8875e-09 1.2923
6.9e-09 1.2923
6.9125e-09 1.2922
6.975e-09 1.2922
6.9875e-09 1.2922
7.0125e-09 1.2922
7.025e-09 1.2921
7.0625e-09 1.2921
7.075e-09 1.2921
7.1375e-09 1.2921
7.15e-09 1.292
7.1625e-09 1.292
7.1875e-09 1.292
7.2e-09 1.292
7.225e-09 1.292
7.2375e-09 1.292
7.25e-09 1.292
7.2625e-09 1.292
7.275e-09 1.2919
7.2875e-09 1.2919
7.3e-09 1.2919
7.3125e-09 1.2919
7.325e-09 1.2919
7.3375e-09 1.2919
7.35e-09 1.2919
7.3625e-09 1.2919
7.375e-09 1.2919
7.3875e-09 1.2919
7.4e-09 1.2918
7.4125e-09 1.2918
7.4375e-09 1.2918
7.45e-09 1.2918
7.4625e-09 1.2918
7.475e-09 1.2918
7.5e-09 1.2918
7.5125e-09 1.2918
7.525e-09 1.2918
7.5375e-09 1.2918
7.55e-09 1.2918
7.5625e-09 1.2918
7.575e-09 1.2917
7.5875e-09 1.2917
7.6e-09 1.2917
7.6125e-09 1.2917
7.625e-09 1.2917
7.6375e-09 1.2917
7.65e-09 1.2917
7.675e-09 1.2917
7.6875e-09 1.2917
7.7e-09 1.2917
7.7125e-09 1.2917
7.7375e-09 1.2917
7.75e-09 1.2917
7.7625e-09 1.2917
7.775e-09 1.2917
7.7875e-09 1.2917
7.8e-09 1.2917
7.825e-09 1.2917
7.8375e-09 1.2917
7.85e-09 1.2916
7.8625e-09 1.2916
7.875e-09 1.2916
7.8875e-09 1.2916
7.9125e-09 1.2916
7.925e-09 1.2916
7.9375e-09 1.2916
7.95e-09 1.2916
7.9875e-09 1.2916
8e-09 1.2916
8.0375e-09 1.2916
8.05e-09 1.2916
8.0875e-09 1.2916
8.1e-09 1.2916
8.1125e-09 1.2916
8.125e-09 1.2915
8.1375e-09 1.2915
8.15e-09 1.2915
8.1875e-09 1.2915
8.2e-09 1.2915
8.2375e-09 1.2915
8.25e-09 1.2915
8.2875e-09 1.2915
8.3e-09 1.2915
8.3375e-09 1.2915
8.35e-09 1.2915
8.4e-09 1.2915
8.4125e-09 1.2915
8.45e-09 1.2915
8.4625e-09 1.2915
8.5e-09 1.2915
8.5125e-09 1.2915
8.55e-09 1.2915
8.5625e-09 1.2915
8.6e-09 1.2915
8.6125e-09 1.2915
8.65e-09 1.2915
8.6625e-09 1.2914
8.7e-09 1.2914
8.7125e-09 1.2914
8.8e-09 1.2914
8.8125e-09 1.2914
8.9125e-09 1.2914
8.925e-09 1.2914
9.0125e-09 1.2914
9.025e-09 1.2914
9.1125e-09 1.2914
9.125e-09 1.2914
9.2125e-09 1.2914
9.225e-09 1.2914
9.325e-09 1.2914
9.3375e-09 1.2914
9.425e-09 1.2914
9.4375e-09 1.2914
9.6e-09 1.2914
9.6125e-09 1.2914
9.8e-09 1.2914
9.8125e-09 1.2914
1e-08 1.2914
1.00125e-08 1.2914
1.01875e-08 1.2914
1.02e-08 1.2914
1.05125e-08 1.2914
1.0525e-08 1.2913
1.05875e-08 1.2913
1.06e-08 1.2913
1.10125e-08 1.2913
1.1025e-08 1.2913
1.1825e-08 1.2913
1.18375e-08 1.2913
1.5e-08 1.2913
End tv FallingWaveform name=fall_1
datapoints tv FallingWaveform name=fall_2 R_fixture=50 V_fixture=0 
0 1.98
2.125e-10 1.98
2.375e-10 1.98
2.5e-10 1.98
2.625e-10 1.98
2.75e-10 1.98
2.875e-10 1.98
3e-10 1.98
3.125e-10 1.9799
3.25e-10 1.9799
3.375e-10 1.98
3.5e-10 1.98
3.625e-10 1.98
3.75e-10 1.9798
3.875e-10 1.9796
4e-10 1.9797
4.125e-10 1.9796
4.25e-10 1.9795
4.375e-10 1.9793
4.5e-10 1.9793
4.625e-10 1.9793
4.75e-10 1.9795
4.875e-10 1.9796
5e-10 1.9803
5.125e-10 1.9818
5.25e-10 1.9837
5.375e-10 1.9858
5.5e-10 1.9873
5.625e-10 1.9879
5.75e-10 1.9877
5.875e-10 1.9868
6e-10 1.9857
6.125e-10 1.9844
6.25e-10 1.983
6.375e-10 1.9815
6.5e-10 1.98
6.625e-10 1.9787
6.75e-10 1.9783
6.875e-10 1.9791
7e-10 1.9811
7.125e-10 1.9835
7.25e-10 1.9857
7.375e-10 1.9863
7.5e-10 1.9841
7.625e-10 1.9783
7.75e-10 1.9677
7.875e-10 1.9518
8e-10 1.9296
8.125e-10 1.9014
8.25e-10 1.8664
8.375e-10 1.8261
8.5e-10 1.7813
8.625e-10 1.7333
8.75e-10 1.684
8.875e-10 1.6322
9e-10 1.5801
9.125e-10 1.5263
9.25e-10 1.4712
9.375e-10 1.415
9.5e-10 1.3532
9.625e-10 1.2877
9.75e-10 1.2163
9.875e-10 1.1386
1e-09 1.0592
1.0125e-09 0.979268
1.025e-09 0.899711
1.0375e-09 0.823597
1.05e-09 0.751092
1.0625e-09 0.683771
1.075e-09 0.622085
1.0875e-09 0.563398
1.1e-09 0.512121
1.1125e-09 0.462653
1.125e-09 0.41843
1.1375e-09 0.376686
1.15e-09 0.338198
1.1625e-09 0.302097
1.175e-09 0.268622
1.1875e-09 0.237333
1.2e-09 0.208373
1.2125e-09 0.181561
1.225e-09 0.157381
1.2375e-09 0.135585
1.25e-09 0.115954
1.2625e-09 0.0989812
1.275e-09 0.0846465
1.2875e-09 0.0712823
1.3e-09 0.0601337
1.3125e-09 0.0504178
1.325e-09 0.0424524
1.3375e-09 0.0352681
1.35e-09 0.0287509
1.3625e-09 0.0233017
1.375e-09 0.0192338
1.3875e-09 0.0155403
1.4e-09 0.0130033
1.4125e-09 0.0108187
1.425e-09 0.0091096
1.4375e-09 0.0078572
1.45e-09 0.0066545
1.4625e-09 0.0055537
1.475e-09 0.0048249
1.4875e-09 0.0041083
1.5e-09 0.0037204
1.5125e-09 0.0033325
1.525e-09 0.0029446
1.5375e-09 0.0025567
1.55e-09 0.0021689
1.5625e-09 0.0020551
1.575e-09 0.0019473
1.5875e-09 0.0018394
1.6e-09 0.0017315
1.6125e-09 0.0016236
1.625e-09 0.0015158
1.6375e-09 0.0014079
1.65e-09 0.0013
1.6625e-09 0.0011921
1.675e-09 0.0010842
1.6875e-09 0.000976367
1.7e-09 0.000951936
1.7125e-09 0.000934424
1.725e-09 0.000916911
1.7375e-09 0.000899399
1.75e-09 0.000881886
1.7625e-09 0.000864374
1.775e-09 0.000846861
1.7875e-09 0.000829348
1.8e-09 0.000811836
1.8125e-09 0.000794323
1.825e-09 0.000776811
1.8375e-09 0.000759298
1.8625e-09 0.000724273
1.875e-09 0.00070676
1.8875e-09 0.000689248
1.9e-09 0.000672621
1.95e-09 0.000623695
1.9625e-09 0.000611463
2.15e-09 0.00042799
2.175e-09 0.000403527
2.1875e-09 0.000392484
2.3875e-09 0.000307879
2.4375e-09 0.000286728
2.4875e-09 0.000265577
2.6875e-09 0.000205486
2.775e-09 0.000179391
2.8625e-09 0.000153295
2.875e-09 0.000150689
3.05e-09 0.000127247
3.1375e-09 0.000115526
3.3375e-09 8.92203e-05
3.525e-09 7.43203e-05
3.6125e-09 6.7367e-05
3.8e-09 5.24952e-05
3.9875e-09 4.04503e-05
4.1375e-09 3.18157e-05
4.7625e-09 1.7238e-05
5.025e-09 1.31664e-05
5.5125e-09 7.3556e-06
5.7375e-09 6.1874e-06
6.1e-09 4.3274e-06
6.45e-09 3.5858e-06
7.0125e-09 2.5312e-06
7.2375e-09 2.2365e-06
7.5875e-09 1.778e-06
8.5125e-09 1.6825e-06
9.1125e-09 1.1646e-06
1.00125e-08 1.4149e-06
1.06375e-08 9.52733e-07
1.15125e-08 1.2554e-06
1.21625e-08 8.54606e-07
1.30125e-08 1.1321e-06
1.37625e-08 8.37811e-07
1.45125e-08 1.0199e-06
1.5e-08 7.25337e-07
End tv FallingWaveform name=fall_2

DATAPOINTS PARASITICS
C_COMP=1.84377e-12
C_COMP_PULLUP=5.53132e-13
C_COMP_PULLDOWN=1.29064e-12
END PARASITICS

END BDRVR ZYNQUPLUSRFSOC_HD_LVCMOS33_S_12_Typ_27degC
