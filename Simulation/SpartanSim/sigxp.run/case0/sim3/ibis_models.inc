DATAPOINTS BDRVR SN65MLVD040_ROUT_Typ_27degC
MODEL_VERSION=2.0
PullUpReference=3.3
PullDownReference=0
PowerClampReference=3.3
GroundClampReference=0

DATAPOINTS AC_PARAM
dVGateOpen=1
dVGateClose=0
ENABLE_ON_VOLT=1
ENABLE_OFF_VOLT=0
RISE_TIME=5.03813e-10
FALL_TIME=4.26685e-10
dVdtr=3.57275e+09
dVdtf=4.18341e+09
END AC_PARAM

DATAPOINTS VI POWER_CLAMP
3.3 0.190757
3.25025 0.186821
3.2005 0.182885
3.15075 0.178951
3.101 0.175018
3.05126 0.171086
3.00151 0.167155
2.95176 0.163225
2.90201 0.159297
2.85226 0.15537
2.80251 0.151444
2.75276 0.14752
2.70302 0.143597
2.65327 0.139676
2.60352 0.135757
2.55377 0.13184
2.50402 0.127924
2.45427 0.124011
2.40452 0.1201
2.35477 0.116192
2.30503 0.112285
2.25528 0.108382
2.20553 0.104482
2.15578 0.100584
2.10603 0.0966904
2.05628 0.0928001
2.00653 0.0889138
1.95678 0.0850318
1.90704 0.0811546
1.85729 0.0772826
1.80754 0.0734163
1.75779 0.0695564
1.70804 0.0657036
1.65829 0.0618587
1.60854 0.0580228
1.55879 0.0541971
1.50904 0.0503831
1.4593 0.0465826
1.40955 0.0427978
1.3598 0.0390318
1.31005 0.0352882
1.2603 0.0315721
1.21055 0.0278902
1.1608 0.024252
1.11105 0.0206714
1.06131 0.0171693
1.01156 0.0137798
0.961809 0.0105606
0.91206 0.00761623
0.862312 0.00513523
0.812563 0.00337139
0.762814 0.00235416
0.713065 0.00174548
0.663317 0.00128483
0.613568 0.000894974
0.563819 0.000566966
0.51407 0.000310558
0.464322 0.00013802
0.414573 4.75907e-05
0.364824 1.31225e-05
0.315075 3.10753e-06
0.265327 6.55031e-07
0.215578 1.24806e-07
0.165829 2.18377e-08
0.11608 3.55845e-09
0.0663317 5.46926e-10
0 6.91631e-11
-0.28191 6.84936e-11
-0.530653 6.28794e-11
-0.779397 5.72652e-11
-0.878894 5.50195e-11
-0.978392 5.27738e-11
-1.02814 5.16509e-11
-1.07789 5.05281e-11
-1.22714 4.71596e-11
-1.27688 4.60367e-11
-1.42613 4.26682e-11
-1.47588 4.15453e-11
-1.62513 3.81768e-11
-1.67487 3.70539e-11
-1.82412 3.36854e-11
-1.87387 3.25626e-11
-2.02312 2.9194e-11
-2.07286 2.80712e-11
-2.22211 2.47026e-11
-2.27186 2.35798e-11
-2.42111 2.02112e-11
-2.47085 1.90884e-11
-2.57035 1.68427e-11
-2.6201 1.57198e-11
-2.76935 1.23513e-11
-2.81909 1.12285e-11
-2.96834 7.85992e-12
-3.01809 6.73708e-12
-3.16734 3.36854e-12
-3.21708 2.24569e-12
-3.31658 0
-3.56533 0
-3.61508 0
-6.6 0
END VI POWER_CLAMP

DATAPOINTS VI ground_clamp
-3.3 -0.18782
-3.25025 -0.183885
-3.2005 -0.17995
-3.15075 -0.176016
-3.101 -0.172084
-3.05126 -0.168152
-3.00151 -0.164222
-2.95176 -0.160293
-2.90201 -0.156365
-2.85226 -0.152439
-2.80251 -0.148514
-2.75276 -0.144591
-2.70302 -0.140669
-2.65327 -0.136749
-2.60352 -0.132831
-2.55377 -0.128915
-2.50402 -0.125
-2.45427 -0.121088
-2.40452 -0.117179
-2.35477 -0.113271
-2.30503 -0.109367
-2.25528 -0.105465
-2.20553 -0.101566
-2.15578 -0.0976708
-2.10603 -0.0937788
-2.05628 -0.0898907
-2.00653 -0.0860068
-1.95678 -0.0821274
-1.90704 -0.078253
-1.85729 -0.0743841
-1.80754 -0.0705213
-1.75779 -0.0666653
-1.70804 -0.0628168
-1.65829 -0.0589768
-1.60854 -0.0551464
-1.55879 -0.051327
-1.50904 -0.0475203
-1.4593 -0.0437283
-1.40955 -0.0399537
-1.3598 -0.0361998
-1.31005 -0.032471
-1.2603 -0.0287732
-1.21055 -0.0251146
-1.1608 -0.0215071
-1.11105 -0.0179679
-1.06131 -0.0145249
-1.01156 -0.0112237
-0.961809 -0.00814597
-0.91206 -0.00544209
-0.862312 -0.00335952
-0.812563 -0.00208281
-0.762814 -0.00138933
-0.713065 -0.000934121
-0.663317 -0.0005825
-0.613568 -0.00031551
-0.563819 -0.000139721
-0.51407 -4.90604e-05
-0.464322 -1.41517e-05
-0.414573 -3.54177e-06
-0.364824 -7.85959e-07
-0.315075 -1.58089e-07
-0.265327 -2.97987e-08
-0.215578 -5.52959e-09
-0.165829 -1.17231e-09
-0.11608 -4.16903e-10
-0.0663317 -2.86104e-10
0 -2.56972e-10
0.28191 -2.36059e-10
0.530653 -2.1671e-10
0.779397 -1.97361e-10
0.878894 -1.89621e-10
0.978392 -1.81881e-10
1.02814 -1.78012e-10
1.07789 -1.74142e-10
1.22714 -1.62532e-10
1.27688 -1.58662e-10
1.42613 -1.47053e-10
1.47588 -1.43183e-10
1.62513 -1.31574e-10
1.67487 -1.27704e-10
1.82412 -1.16094e-10
1.87387 -1.12225e-10
2.02312 -1.00615e-10
2.07286 -9.67454e-11
2.22211 -8.51359e-11
2.27186 -8.12661e-11
2.42111 -6.96567e-11
2.47085 -6.57869e-11
2.57035 -5.80472e-11
2.6201 -5.41774e-11
2.76935 -4.2568e-11
2.81909 -3.86981e-11
2.96834 -2.70887e-11
3.01809 -2.32189e-11
3.16734 -1.16094e-11
3.21708 -7.73963e-12
3.31658 0
3.56533 0
3.61508 0
6.6 0
END VI ground_clamp

DATAPOINTS VI PULL_UP
3.3 0.0004181
2.55377 0.0006292
2.45427 0.0006747
2.15578 0.0008616
2.05628 0.0009493
1.95678 0.00105689
1.90704 0.00112038
1.75779 0.00136667
1.70804 0.0014747
1.65829 0.00160124
1.60854 0.00175145
1.55879 0.00193259
1.50904 0.00215519
1.4593 0.00243494
1.40955 0.00279613
1.3598 0.00327758
1.31005 0.00394194
1.2603 0.00488456
1.21055 0.00621363
1.1608 0.00794982
1.11105 0.00994591
1.06131 0.0120088
1.01156 0.0140094
0.961809 0.0158544
0.91206 0.0174282
0.862312 0.0185391
0.812563 0.0189324
0.762814 0.0185787
0.713065 0.017816
0.663317 0.0169051
0.613568 0.0159233
0.563819 0.0148799
0.51407 0.0137653
0.464322 0.0125674
0.414573 0.0112884
0.364824 0.00995458
0 6.19433e-08
-0.182412 -0.00488181
-0.232161 -0.00619233
-0.331658 -0.00878555
-0.381407 -0.010068
-0.431156 -0.0113407
-0.530653 -0.0138564
-0.580402 -0.0150992
-0.679899 -0.0175533
-0.779397 -0.0199646
-0.878894 -0.0223315
-0.978392 -0.0246524
-1.02814 -0.025795
-1.12764 -0.0280435
-1.17739 -0.0291489
-1.32663 -0.0323867
-1.47588 -0.0355012
-1.52563 -0.0365107
-1.62513 -0.0384845
-1.67487 -0.0394482
-1.72462 -0.0403961
-1.77437 -0.0413277
-1.82412 -0.0422426
-1.92362 -0.044021
-1.97337 -0.0448836
-2.07286 -0.0465535
-2.12261 -0.0473598
-2.17236 -0.0481464
-2.27186 -0.0496585
-2.32161 -0.0503828
-2.42111 -0.0517652
-2.47085 -0.0524221
-2.5206 -0.0530553
-2.57035 -0.0536642
-2.66985 -0.0548066
-2.7196 -0.0553389
-2.81909 -0.0563237
-2.96834 -0.0576031
-3.11759 -0.0586745
-3.16734 -0.058995
-3.26683 -0.0595924
-3.36633 -0.0601402
-3.41608 -0.060398
-3.51558 -0.0608848
-3.61508 -0.0613374
-3.66482 -0.0615522
-3.81407 -0.0621555
-3.86382 -0.0623443
-3.96332 -0.0627051
-4.06281 -0.0630456
-4.11256 -0.063209
-4.31156 -0.0638211
-4.41106 -0.064105
-4.51055 -0.0643761
-4.5603 -0.0645071
-4.7593 -0.0650043
-5.00804 -0.0655729
-5.10754 -0.0657864
-5.25678 -0.0660933
-5.45578 -0.0664806
-5.75427 -0.0670214
-5.80402 -0.0671073
-5.85377 -0.0671923
-6.6 -0.068358
END VI PULL_UP

DATAPOINTS VI pull_down
-3.3 -0.0004583
-2.90201 -0.0005611
-2.80251 -0.0005945
-2.55377 -0.0006983
-2.45427 -0.0007509
-2.25528 -0.0008838
-2.15578 -0.00096968
-2.05628 -0.00107408
-1.95678 -0.00120373
-1.90704 -0.00128107
-1.80754 -0.00147004
-1.75779 -0.00158714
-1.70804 -0.00172456
-1.65829 -0.00188807
-1.60854 -0.00208585
-1.55879 -0.00232985
-1.50904 -0.00263812
-1.4593 -0.00303897
-1.40955 -0.00357819
-1.3598 -0.00433043
-1.31005 -0.0054069
-1.2603 -0.00691705
-1.21055 -0.00883883
-1.1608 -0.0109828
-1.11105 -0.0131648
-1.06131 -0.0152803
-1.01156 -0.0172574
-0.961809 -0.0190069
-0.91206 -0.020376
-0.862312 -0.0211167
-0.812563 -0.0210441
-0.762814 -0.0203808
-0.713065 -0.0194717
-0.663317 -0.0184516
-0.613568 -0.0173391
-0.563819 -0.0161279
-0.51407 -0.0148238
-0.464322 -0.0134563
-0.414573 -0.0120567
-0.364824 -0.0106414
-0.215578 -0.00634078
0 -3.53868e-07
0.132663 0.00388541
0.232161 0.00671419
0.28191 0.00810052
0.381407 0.0108159
0.431156 0.0121445
0.530653 0.0147422
0.580402 0.0160108
0.630151 0.0172588
0.679899 0.0184861
0.729648 0.0196924
0.779397 0.0208773
0.878894 0.023182
0.928643 0.0243012
1.02814 0.0264718
1.12764 0.0285498
1.17739 0.0295532
1.22714 0.0305325
1.27688 0.0314873
1.32663 0.0324172
1.37638 0.0333217
1.42613 0.0342005
1.47588 0.0350531
1.52563 0.0358789
1.57538 0.0366773
1.62513 0.0374476
1.67487 0.0381888
1.72462 0.0388997
1.77437 0.0395788
1.82412 0.0402236
1.87387 0.0408314
1.92362 0.0413982
1.97337 0.04192
2.02312 0.0423932
2.07286 0.0428162
2.12261 0.0431899
2.17236 0.0435178
2.22211 0.043805
2.27186 0.0440569
2.32161 0.044279
2.37136 0.0444761
2.42111 0.0446521
2.47085 0.0448105
2.5206 0.0449541
2.57035 0.0450851
2.66985 0.0453166
2.7196 0.0454199
2.81909 0.0456069
2.91859 0.0457731
3.01809 0.0459232
3.11759 0.0460604
3.16734 0.0461251
3.46583 0.0464715
3.66482 0.046674
4.16231 0.0471217
4.36131 0.0472853
5.15729 0.0478901
5.30653 0.0479975
6.6 0.0488854
END VI pull_down
datapoints tv RisingWaveform name=rise_1 R_fixture=50 V_fixture=3.3 
0 1.51493
1e-10 1.51493
1.1e-10 1.52434
1.2e-10 1.521
1.3e-10 1.50906
1.4e-10 1.48931
1.5e-10 1.47344
1.6e-10 1.46
1.7e-10 1.45228
1.8e-10 1.45162
1.9e-10 1.45778
2e-10 1.47071
2.1e-10 1.49061
2.2e-10 1.51691
2.3e-10 1.54918
2.4e-10 1.58661
2.5e-10 1.62917
2.6e-10 1.6758
2.7e-10 1.72699
2.8e-10 1.78245
2.9e-10 1.84209
3e-10 1.90602
3.1e-10 1.97233
3.2e-10 2.04182
3.3e-10 2.1124
3.4e-10 2.17841
3.5e-10 2.24299
3.6e-10 2.30352
3.7e-10 2.35912
3.8e-10 2.41082
3.9e-10 2.45921
4e-10 2.50403
4.1e-10 2.5457
4.2e-10 2.58531
4.3e-10 2.62225
4.4e-10 2.6566
4.5e-10 2.68989
4.6e-10 2.72129
4.7e-10 2.75079
4.8e-10 2.77932
4.9e-10 2.80667
5e-10 2.83268
5.1e-10 2.85772
5.2e-10 2.88195
5.3e-10 2.90518
5.4e-10 2.92749
5.5e-10 2.94912
5.6e-10 2.96991
5.7e-10 2.98988
5.8e-10 3.00919
5.9e-10 3.02774
6e-10 3.04555
6.1e-10 3.06268
6.2e-10 3.07912
6.3e-10 3.09486
6.4e-10 3.10993
6.5e-10 3.12437
6.6e-10 3.13813
6.7e-10 3.15124
6.8e-10 3.16368
6.9e-10 3.17553
7e-10 3.1868
7.1e-10 3.19744
7.2e-10 3.20747
7.3e-10 3.21687
7.4e-10 3.22565
7.5e-10 3.2339
7.6e-10 3.24161
7.7e-10 3.24874
7.8e-10 3.25529
7.9e-10 3.26125
8e-10 3.26664
8.1e-10 3.27151
8.2e-10 3.27585
8.3e-10 3.27965
8.4e-10 3.28289
8.5e-10 3.28557
8.6e-10 3.28771
8.7e-10 3.28971
8.8e-10 3.29147
8.9e-10 3.29285
9e-10 3.29386
9.1e-10 3.29449
9.2e-10 3.29474
9.3e-10 3.29522
9.4e-10 3.29578
9.5e-10 3.29622
9.6e-10 3.29652
9.7e-10 3.2967
9.8e-10 3.29676
9.9e-10 3.29669
1e-09 3.2967
1.01e-09 3.29685
1.02e-09 3.29697
1.03e-09 3.29708
1.04e-09 3.29716
1.05e-09 3.29721
1.06e-09 3.29724
1.07e-09 3.29728
1.08e-09 3.29737
1.09e-09 3.29745
1.1e-09 3.29753
1.11e-09 3.29762
1.12e-09 3.2977
1.13e-09 3.29778
1.14e-09 3.29787
1.15e-09 3.29795
1.16e-09 3.29803
1.17e-09 3.2981
1.18e-09 3.29818
1.19e-09 3.29825
1.2e-09 3.29832
1.21e-09 3.29839
1.22e-09 3.29846
1.23e-09 3.29853
1.24e-09 3.29859
1.25e-09 3.29865
1.26e-09 3.29872
1.27e-09 3.29878
1.28e-09 3.29883
1.29e-09 3.29889
1.3e-09 3.29894
1.31e-09 3.29899
1.32e-09 3.29904
1.33e-09 3.29909
1.34e-09 3.29913
1.35e-09 3.29917
1.36e-09 3.29921
1.37e-09 3.29925
1.38e-09 3.29929
1.39e-09 3.29932
1.4e-09 3.29935
1.41e-09 3.29938
1.42e-09 3.29941
1.43e-09 3.29944
1.44e-09 3.29947
1.45e-09 3.2995
1.46e-09 3.29953
1.47e-09 3.29955
1.48e-09 3.29957
1.49e-09 3.2996
1.5e-09 3.29962
1.51e-09 3.29964
1.52e-09 3.29965
1.53e-09 3.29967
1.54e-09 3.29969
1.55e-09 3.2997
1.56e-09 3.29971
1.57e-09 3.29973
1.58e-09 3.29974
1.59e-09 3.29976
1.6e-09 3.29977
1.61e-09 3.29979
1.62e-09 3.2998
1.63e-09 3.29981
1.64e-09 3.29982
1.65e-09 3.29983
1.66e-09 3.29984
1.67e-09 3.29985
1.68e-09 3.29986
1.69e-09 3.29987
1.7e-09 3.29987
1.71e-09 3.29988
1.72e-09 3.29989
1.73e-09 3.29989
1.74e-09 3.29989
1.75e-09 3.2999
1.76e-09 3.29991
1.77e-09 3.29991
1.78e-09 3.29992
1.79e-09 3.29993
1.8e-09 3.29993
1.81e-09 3.29994
1.82e-09 3.29994
1.83e-09 3.29995
1.85e-09 3.29995
1.86e-09 3.29996
1.87e-09 3.29996
1.88e-09 3.29996
1.89e-09 3.29997
1.9e-09 3.29997
1.91e-09 3.29997
1.92e-09 3.29997
1.93e-09 3.29997
1.94e-09 3.29997
1.95e-09 3.29997
1.96e-09 3.29998
1.97e-09 3.29998
1.98e-09 3.29998
1.99e-09 3.29998
2e-09 3.29998
2.01e-09 3.29999
2.02e-09 3.29999
2.03e-09 3.29999
2.04e-09 3.29999
2.05e-09 3.29999
2.06e-09 3.29999
2.07e-09 3.3
2.08e-09 3.3
2.09e-09 3.3
2.1e-09 3.3
2.11e-09 3.3
2.12e-09 3.3
2.13e-09 3.3
2.14e-09 3.3
2.15e-09 3.3
2.16e-09 3.3
2.17e-09 3.3
2.18e-09 3.3
2.19e-09 3.3
2.2e-09 3.3
2.21e-09 3.3
2.24e-09 3.3
2.25e-09 3.3
2.26e-09 3.3
2.27e-09 3.3
2.28e-09 3.3
2.29e-09 3.3
2.3e-09 3.3
2.31e-09 3.3
2.32e-09 3.3
2.34e-09 3.3
2.35e-09 3.3
2.36e-09 3.3
2.37e-09 3.3
2.38e-09 3.3
2.39e-09 3.3
2.4e-09 3.3
2.41e-09 3.3
2.42e-09 3.3
2.43e-09 3.3
2.44e-09 3.3
2.46e-09 3.3
2.47e-09 3.3
2.48e-09 3.3
2.49e-09 3.3
2.5e-09 3.3
2.51e-09 3.3
2.52e-09 3.3
2.53e-09 3.3
2.57e-09 3.3
2.58e-09 3.3
2.63e-09 3.3
2.64e-09 3.29999
2.65e-09 3.29999
2.67e-09 3.29999
2.68e-09 3.29999
2.69e-09 3.29999
2.7e-09 3.29999
2.71e-09 3.29999
2.72e-09 3.29999
2.73e-09 3.29999
2.74e-09 3.29999
2.75e-09 3.29999
2.78e-09 3.29999
2.79e-09 3.29999
2.83e-09 3.29999
2.84e-09 3.29999
2.85e-09 3.29999
2.86e-09 3.29999
2.87e-09 3.29999
2.88e-09 3.29999
2.91e-09 3.29999
2.92e-09 3.29999
2.94e-09 3.29999
2.95e-09 3.29999
2.96e-09 3.29999
2.97e-09 3.29999
3e-09 3.29999
3.01e-09 3.29999
3.03e-09 3.29999
3.04e-09 3.29999
3.05e-09 3.29999
3.06e-09 3.29999
3.07e-09 3.29999
3.1e-09 3.29999
3.11e-09 3.29999
3.12e-09 3.29998
3.15e-09 3.29998
3.16e-09 3.29998
3.2e-09 3.29998
3.21e-09 3.29998
3.22e-09 3.29998
3.28e-09 3.29998
3.29e-09 3.29998
3.33e-09 3.29998
3.34e-09 3.29998
3.37e-09 3.29998
3.38e-09 3.29998
3.46e-09 3.29998
3.47e-09 3.29998
3.5e-09 3.29998
End tv RisingWaveform name=rise_1
datapoints tv RisingWaveform name=rise_2 R_fixture=50 V_fixture=0 
0 2.03939e-05
1e-11 2.03911e-05
2e-11 2.03879e-05
3e-11 2.03844e-05
4e-11 2.03806e-05
5e-11 2.03765e-05
6e-11 2.03721e-05
7e-11 2.03674e-05
8e-11 2.03624e-05
9e-11 2.0357e-05
1e-10 2.03514e-05
1.1e-10 0.0109956
1.2e-10 0.0107468
1.3e-10 0.00453549
1.4e-10 -0.00903788
1.5e-10 -0.0189509
1.6e-10 -0.0277599
1.7e-10 -0.0327353
1.8e-10 -0.0326892
1.9e-10 -0.0279412
2e-10 -0.0185391
2.1e-10 -0.00435599
2.2e-10 0.0139595
2.3e-10 0.0359646
2.4e-10 0.0608279
2.5e-10 0.0884423
2.6e-10 0.117509
2.7e-10 0.148616
2.8e-10 0.180792
2.9e-10 0.213705
3e-10 0.247738
3.1e-10 0.281804
3.2e-10 0.316354
3.3e-10 0.351232
3.4e-10 0.38596
3.5e-10 0.420804
3.6e-10 0.45556
3.7e-10 0.49016
3.8e-10 0.524683
3.9e-10 0.559069
4e-10 0.593342
4.1e-10 0.627556
4.2e-10 0.661848
4.3e-10 0.69614
4.4e-10 0.730462
4.5e-10 0.765326
4.6e-10 0.80045
4.7e-10 0.835835
4.8e-10 0.872261
4.9e-10 0.909545
5e-10 0.947559
5.1e-10 0.986612
5.2e-10 1.02685
5.3e-10 1.06809
5.4e-10 1.10965
5.5e-10 1.15002
5.6e-10 1.1902
5.7e-10 1.23003
5.8e-10 1.26695
5.9e-10 1.30237
6e-10 1.33629
6.1e-10 1.36828
6.2e-10 1.39846
6.3e-10 1.42689
6.4e-10 1.4538
6.5e-10 1.47926
6.6e-10 1.50317
6.7e-10 1.52552
6.8e-10 1.54632
6.9e-10 1.56616
7e-10 1.58498
7.1e-10 1.60257
7.2e-10 1.61891
7.3e-10 1.63401
7.4e-10 1.64787
7.5e-10 1.66107
7.6e-10 1.6735
7.7e-10 1.68494
7.8e-10 1.69539
7.9e-10 1.70486
8e-10 1.71333
8.1e-10 1.72123
8.2e-10 1.72846
8.3e-10 1.73488
8.4e-10 1.74048
8.5e-10 1.74527
8.6e-10 1.74924
8.7e-10 1.75311
8.8e-10 1.75671
8.9e-10 1.75978
9e-10 1.76235
9.1e-10 1.76439
9.2e-10 1.76592
9.3e-10 1.7677
9.4e-10 1.76954
9.5e-10 1.77118
9.6e-10 1.77263
9.7e-10 1.77387
9.8e-10 1.77492
9.9e-10 1.77577
1e-09 1.77668
1.01e-09 1.77773
1.02e-09 1.77871
1.03e-09 1.77962
1.04e-09 1.78046
1.05e-09 1.78124
1.06e-09 1.78194
1.07e-09 1.78262
1.08e-09 1.78336
1.09e-09 1.78407
1.1e-09 1.78475
1.11e-09 1.7854
1.12e-09 1.78603
1.13e-09 1.78662
1.14e-09 1.78718
1.15e-09 1.78772
1.16e-09 1.78822
1.17e-09 1.78873
1.18e-09 1.78923
1.19e-09 1.78971
1.2e-09 1.79018
1.21e-09 1.79062
1.22e-09 1.79104
1.23e-09 1.79144
1.24e-09 1.79183
1.25e-09 1.79219
1.26e-09 1.79253
1.27e-09 1.79286
1.28e-09 1.79316
1.29e-09 1.79346
1.3e-09 1.79376
1.31e-09 1.79406
1.32e-09 1.79434
1.33e-09 1.7946
1.34e-09 1.79486
1.35e-09 1.79509
1.36e-09 1.79532
1.37e-09 1.79553
1.38e-09 1.79573
1.39e-09 1.79591
1.4e-09 1.79608
1.41e-09 1.79624
1.42e-09 1.79642
1.43e-09 1.7966
1.44e-09 1.79676
1.45e-09 1.79692
1.46e-09 1.79707
1.47e-09 1.79721
1.48e-09 1.79735
1.49e-09 1.79747
1.5e-09 1.79759
1.51e-09 1.7977
1.52e-09 1.79781
1.53e-09 1.7979
1.54e-09 1.79799
1.55e-09 1.79807
1.56e-09 1.79814
1.57e-09 1.79824
1.58e-09 1.79832
1.59e-09 1.79841
1.6e-09 1.79849
1.61e-09 1.79857
1.62e-09 1.79865
1.63e-09 1.79872
1.64e-09 1.79878
1.65e-09 1.79884
1.66e-09 1.7989
1.67e-09 1.79895
1.68e-09 1.799
1.69e-09 1.79905
1.7e-09 1.79909
1.71e-09 1.79913
1.72e-09 1.79916
1.73e-09 1.79919
1.74e-09 1.79921
1.75e-09 1.79925
1.76e-09 1.79929
1.77e-09 1.79933
1.78e-09 1.79937
1.79e-09 1.7994
1.8e-09 1.79943
1.81e-09 1.79947
1.82e-09 1.79949
1.83e-09 1.79952
1.84e-09 1.79955
1.85e-09 1.79957
1.86e-09 1.79959
1.87e-09 1.79961
1.88e-09 1.79963
1.89e-09 1.79964
1.9e-09 1.79966
1.91e-09 1.79967
1.92e-09 1.79968
1.93e-09 1.79969
1.94e-09 1.79969
1.95e-09 1.7997
1.96e-09 1.79971
1.97e-09 1.79972
1.98e-09 1.79974
1.99e-09 1.79975
2e-09 1.79976
2.01e-09 1.79977
2.02e-09 1.79978
2.03e-09 1.79979
2.04e-09 1.7998
2.05e-09 1.79981
2.06e-09 1.79982
2.07e-09 1.79983
2.08e-09 1.79983
2.09e-09 1.79984
2.1e-09 1.79984
2.11e-09 1.79985
2.12e-09 1.79985
2.13e-09 1.79986
2.14e-09 1.79986
2.15e-09 1.79986
2.16e-09 1.79986
2.17e-09 1.79986
2.18e-09 1.79986
2.19e-09 1.79986
2.2e-09 1.79986
2.21e-09 1.79986
2.22e-09 1.79985
2.23e-09 1.79985
2.24e-09 1.79986
2.25e-09 1.79986
2.26e-09 1.79986
2.27e-09 1.79986
2.28e-09 1.79987
2.29e-09 1.79987
2.3e-09 1.79987
2.31e-09 1.79987
2.32e-09 1.79987
2.33e-09 1.79987
2.34e-09 1.79987
2.35e-09 1.79987
2.36e-09 1.79987
2.37e-09 1.79987
2.38e-09 1.79987
2.39e-09 1.79987
2.4e-09 1.79987
2.41e-09 1.79987
2.42e-09 1.79987
2.43e-09 1.79987
2.44e-09 1.79987
2.45e-09 1.79987
2.46e-09 1.79987
2.47e-09 1.79986
2.48e-09 1.79986
2.49e-09 1.79986
2.5e-09 1.79986
2.51e-09 1.79985
2.52e-09 1.79985
2.53e-09 1.79985
2.54e-09 1.79984
2.55e-09 1.79984
2.56e-09 1.79984
2.57e-09 1.79984
2.59e-09 1.79984
2.6e-09 1.79984
2.61e-09 1.79984
2.63e-09 1.79984
2.64e-09 1.79984
2.65e-09 1.79984
2.66e-09 1.79984
2.67e-09 1.79983
2.68e-09 1.79983
2.69e-09 1.79983
2.7e-09 1.79983
2.71e-09 1.79983
2.72e-09 1.79983
2.73e-09 1.79983
2.74e-09 1.79983
2.76e-09 1.79983
2.77e-09 1.79982
2.78e-09 1.79982
2.79e-09 1.79982
2.8e-09 1.79982
2.81e-09 1.79982
2.82e-09 1.79982
2.83e-09 1.79982
2.84e-09 1.79981
2.85e-09 1.79981
2.86e-09 1.79981
2.87e-09 1.79981
2.88e-09 1.79981
2.89e-09 1.79981
2.9e-09 1.79981
2.91e-09 1.7998
2.92e-09 1.7998
2.93e-09 1.7998
2.94e-09 1.7998
2.95e-09 1.7998
2.96e-09 1.7998
2.97e-09 1.7998
2.98e-09 1.7998
2.99e-09 1.7998
3e-09 1.7998
3.01e-09 1.7998
3.02e-09 1.79979
3.03e-09 1.79979
3.04e-09 1.79979
3.05e-09 1.79979
3.06e-09 1.79979
3.07e-09 1.79979
3.08e-09 1.79979
3.09e-09 1.79979
3.1e-09 1.79979
3.11e-09 1.79979
3.12e-09 1.79979
3.13e-09 1.79979
3.14e-09 1.79978
3.15e-09 1.79978
3.16e-09 1.79978
3.17e-09 1.79978
3.18e-09 1.79978
3.19e-09 1.79978
3.2e-09 1.79978
3.21e-09 1.79978
3.22e-09 1.79978
3.23e-09 1.79978
3.24e-09 1.79978
3.25e-09 1.79978
3.26e-09 1.79978
3.27e-09 1.79978
3.28e-09 1.79978
3.29e-09 1.79978
3.3e-09 1.79978
3.31e-09 1.79977
3.33e-09 1.79977
3.34e-09 1.79977
3.35e-09 1.79977
3.36e-09 1.79977
3.37e-09 1.79977
3.38e-09 1.79977
3.39e-09 1.79977
3.4e-09 1.79977
3.41e-09 1.79977
3.42e-09 1.79977
3.43e-09 1.79977
3.44e-09 1.79977
3.45e-09 1.79977
3.46e-09 1.79977
3.47e-09 1.79977
3.49e-09 1.79977
3.5e-09 1.79977
End tv RisingWaveform name=rise_2
datapoints tv FallingWaveform name=fall_1 R_fixture=50 V_fixture=3.3 
0 3.29998
1e-10 3.29998
1.1e-10 3.28977
1.2e-10 3.29055
1.3e-10 3.3006
1.4e-10 3.31578
1.5e-10 3.32809
1.6e-10 3.33768
1.7e-10 3.34364
1.8e-10 3.34431
1.9e-10 3.33785
2e-10 3.3239
2.1e-10 3.30306
2.2e-10 3.27738
2.3e-10 3.24753
2.4e-10 3.2151
2.5e-10 3.18014
2.6e-10 3.14467
2.7e-10 3.10777
2.8e-10 3.07056
2.9e-10 3.03342
3e-10 2.99592
3.1e-10 2.95893
3.2e-10 2.92208
3.3e-10 2.8854
3.4e-10 2.849
3.5e-10 2.81281
3.6e-10 2.77666
3.7e-10 2.74049
3.8e-10 2.70437
3.9e-10 2.66758
4e-10 2.63043
4.1e-10 2.5925
4.2e-10 2.55266
4.3e-10 2.51153
4.4e-10 2.469
4.5e-10 2.4227
4.6e-10 2.37393
4.7e-10 2.32268
4.8e-10 2.27227
4.9e-10 2.2219
5e-10 2.17103
5.1e-10 2.12185
5.2e-10 2.07534
5.3e-10 2.03031
5.4e-10 1.98719
5.5e-10 1.94692
5.6e-10 1.90887
5.7e-10 1.87307
5.8e-10 1.84005
5.9e-10 1.80951
6e-10 1.78147
6.1e-10 1.75573
6.2e-10 1.73234
6.3e-10 1.71134
6.4e-10 1.6921
6.5e-10 1.6744
6.6e-10 1.65855
6.7e-10 1.64454
6.8e-10 1.63238
6.9e-10 1.62092
7e-10 1.61027
7.1e-10 1.60087
7.2e-10 1.59271
7.3e-10 1.5858
7.4e-10 1.58014
7.5e-10 1.57458
7.6e-10 1.56933
7.7e-10 1.56483
7.8e-10 1.56109
7.9e-10 1.55809
8e-10 1.55584
8.1e-10 1.55335
8.2e-10 1.55082
8.3e-10 1.54862
8.4e-10 1.54675
8.5e-10 1.54521
8.6e-10 1.54399
8.7e-10 1.54259
8.8e-10 1.54113
8.9e-10 1.53979
9e-10 1.53856
9.1e-10 1.53745
9.2e-10 1.53645
9.3e-10 1.53541
9.4e-10 1.53438
9.5e-10 1.5334
9.6e-10 1.53247
9.7e-10 1.5316
9.8e-10 1.53078
9.9e-10 1.53001
1e-09 1.52926
1.01e-09 1.52852
1.02e-09 1.52782
1.03e-09 1.52716
1.04e-09 1.52653
1.05e-09 1.52594
1.06e-09 1.52539
1.07e-09 1.52486
1.08e-09 1.52433
1.09e-09 1.52383
1.1e-09 1.52335
1.11e-09 1.5229
1.12e-09 1.52248
1.13e-09 1.52208
1.14e-09 1.52171
1.15e-09 1.52136
1.16e-09 1.52104
1.17e-09 1.52071
1.18e-09 1.52039
1.19e-09 1.52008
1.2e-09 1.51978
1.21e-09 1.51951
1.22e-09 1.51925
1.23e-09 1.519
1.24e-09 1.51877
1.25e-09 1.51856
1.26e-09 1.51837
1.27e-09 1.51819
1.28e-09 1.51802
1.29e-09 1.51786
1.3e-09 1.51768
1.31e-09 1.51751
1.32e-09 1.51736
1.33e-09 1.51721
1.34e-09 1.51707
1.35e-09 1.51694
1.36e-09 1.51682
1.37e-09 1.51671
1.38e-09 1.51661
1.39e-09 1.51652
1.4e-09 1.51644
1.41e-09 1.51636
1.42e-09 1.51627
1.43e-09 1.51618
1.44e-09 1.51609
1.45e-09 1.51602
1.46e-09 1.51594
1.47e-09 1.51587
1.48e-09 1.51581
1.49e-09 1.51575
1.5e-09 1.51569
1.51e-09 1.51564
1.52e-09 1.5156
1.53e-09 1.51555
1.54e-09 1.51552
1.55e-09 1.51549
1.56e-09 1.51546
1.57e-09 1.51542
1.58e-09 1.51538
1.59e-09 1.51534
1.6e-09 1.5153
1.61e-09 1.51527
1.62e-09 1.51524
1.63e-09 1.51521
1.64e-09 1.51518
1.65e-09 1.51515
1.66e-09 1.51513
1.67e-09 1.51511
1.68e-09 1.51509
1.69e-09 1.51508
1.7e-09 1.51506
1.71e-09 1.51505
1.72e-09 1.51504
1.73e-09 1.51503
1.74e-09 1.51503
1.75e-09 1.51501
1.76e-09 1.515
1.77e-09 1.51499
1.78e-09 1.51497
1.79e-09 1.51496
1.8e-09 1.51495
1.81e-09 1.51494
1.82e-09 1.51493
1.83e-09 1.51492
1.84e-09 1.51491
1.85e-09 1.5149
1.86e-09 1.5149
1.87e-09 1.51489
1.88e-09 1.51489
1.89e-09 1.51489
1.9e-09 1.51488
1.91e-09 1.51488
1.92e-09 1.51488
1.93e-09 1.51488
1.94e-09 1.51488
1.95e-09 1.51488
1.96e-09 1.51488
1.97e-09 1.51488
1.98e-09 1.51488
1.99e-09 1.51487
2e-09 1.51487
2.01e-09 1.51487
2.02e-09 1.51486
2.03e-09 1.51486
2.04e-09 1.51486
2.05e-09 1.51486
2.06e-09 1.51486
2.07e-09 1.51486
2.08e-09 1.51486
2.09e-09 1.51486
2.1e-09 1.51486
2.11e-09 1.51486
2.12e-09 1.51486
2.13e-09 1.51486
2.14e-09 1.51486
2.15e-09 1.51486
2.16e-09 1.51486
2.17e-09 1.51486
2.18e-09 1.51486
2.19e-09 1.51486
2.2e-09 1.51487
2.21e-09 1.51487
2.22e-09 1.51487
2.23e-09 1.51487
2.24e-09 1.51487
2.25e-09 1.51487
2.26e-09 1.51487
2.28e-09 1.51487
2.29e-09 1.51487
2.3e-09 1.51487
2.31e-09 1.51487
2.32e-09 1.51487
2.33e-09 1.51488
2.34e-09 1.51488
2.35e-09 1.51488
2.36e-09 1.51488
2.38e-09 1.51488
2.39e-09 1.51488
2.43e-09 1.51488
2.44e-09 1.51489
2.45e-09 1.51489
2.46e-09 1.51489
2.47e-09 1.51489
2.48e-09 1.51489
2.49e-09 1.51489
2.5e-09 1.51489
2.51e-09 1.5149
2.52e-09 1.5149
2.53e-09 1.5149
2.54e-09 1.5149
2.55e-09 1.5149
2.56e-09 1.5149
2.57e-09 1.5149
2.58e-09 1.5149
2.59e-09 1.5149
2.6e-09 1.5149
2.61e-09 1.5149
2.62e-09 1.5149
2.63e-09 1.5149
2.64e-09 1.51491
2.65e-09 1.51491
2.66e-09 1.51491
2.67e-09 1.51491
2.68e-09 1.51491
2.69e-09 1.51491
2.7e-09 1.51491
2.71e-09 1.51491
2.72e-09 1.51491
2.73e-09 1.51491
2.74e-09 1.51491
2.75e-09 1.51491
2.76e-09 1.51491
2.77e-09 1.51491
2.78e-09 1.51491
2.79e-09 1.51492
2.8e-09 1.51492
2.81e-09 1.51492
2.82e-09 1.51492
2.83e-09 1.51492
2.84e-09 1.51492
2.85e-09 1.51492
2.86e-09 1.51492
2.87e-09 1.51492
2.88e-09 1.51492
2.89e-09 1.51492
2.9e-09 1.51492
2.91e-09 1.51492
2.92e-09 1.51492
2.93e-09 1.51492
2.94e-09 1.51492
2.95e-09 1.51492
2.96e-09 1.51492
2.97e-09 1.51492
2.98e-09 1.51492
2.99e-09 1.51492
3e-09 1.51492
3.01e-09 1.51493
3.02e-09 1.51493
3.03e-09 1.51493
3.04e-09 1.51493
3.05e-09 1.51493
3.06e-09 1.51493
3.07e-09 1.51493
3.08e-09 1.51493
3.1e-09 1.51493
3.11e-09 1.51493
3.12e-09 1.51493
3.13e-09 1.51493
3.15e-09 1.51493
3.16e-09 1.51493
3.17e-09 1.51493
3.18e-09 1.51493
3.2e-09 1.51493
3.21e-09 1.51493
3.23e-09 1.51493
3.24e-09 1.51493
3.26e-09 1.51493
3.27e-09 1.51493
3.3e-09 1.51493
3.31e-09 1.51493
3.34e-09 1.51493
3.35e-09 1.51493
3.38e-09 1.51493
3.39e-09 1.51493
3.44e-09 1.51493
3.45e-09 1.51493
3.5e-09 1.51493
End tv FallingWaveform name=fall_1
datapoints tv FallingWaveform name=fall_2 R_fixture=50 V_fixture=0 
0 1.79977
1e-11 1.79977
2e-11 1.79977
8e-11 1.79977
9e-11 1.79977
1e-10 1.79977
1.1e-10 1.78923
1.2e-10 1.79208
1.3e-10 1.80428
1.4e-10 1.82044
1.5e-10 1.83066
1.6e-10 1.83546
1.7e-10 1.83432
1.8e-10 1.82647
1.9e-10 1.81005
2e-10 1.78429
2.1e-10 1.74909
2.2e-10 1.70575
2.3e-10 1.65467
2.4e-10 1.59678
2.5e-10 1.5316
2.6e-10 1.45872
2.7e-10 1.37833
2.8e-10 1.29208
2.9e-10 1.20054
3e-10 1.10306
3.1e-10 1.01421
3.2e-10 0.927929
3.3e-10 0.84564
3.4e-10 0.771919
3.5e-10 0.704217
3.6e-10 0.642663
3.7e-10 0.587302
3.8e-10 0.538083
3.9e-10 0.492793
4e-10 0.452361
4.1e-10 0.416105
4.2e-10 0.382123
4.3e-10 0.351478
4.4e-10 0.324052
4.5e-10 0.297686
4.6e-10 0.273561
4.7e-10 0.251679
4.8e-10 0.23092
4.9e-10 0.211547
5e-10 0.193745
5.1e-10 0.177105
5.2e-10 0.161442
5.3e-10 0.146977
5.4e-10 0.13358
5.5e-10 0.120965
5.6e-10 0.109326
5.7e-10 0.0986396
5.8e-10 0.0885923
5.9e-10 0.0793578
6e-10 0.0709359
6.1e-10 0.0630998
6.2e-10 0.055911
6.3e-10 0.0494022
6.4e-10 0.0434285
6.5e-10 0.037934
6.6e-10 0.0329923
6.7e-10 0.0286033
6.8e-10 0.024767
6.9e-10 0.0212735
7e-10 0.0181396
7.1e-10 0.0154477
7.2e-10 0.0131975
7.3e-10 0.0113893
7.4e-10 0.0100229
7.5e-10 0.00871082
7.6e-10 0.00752334
7.7e-10 0.00660924
7.8e-10 0.00596851
7.9e-10 0.00560116
8e-10 0.00550719
8.1e-10 0.00523358
8.2e-10 0.00487546
8.3e-10 0.00459741
8.4e-10 0.00439943
8.5e-10 0.00428151
8.6e-10 0.00424366
8.7e-10 0.00412
8.8e-10 0.00394987
8.9e-10 0.0037903
9e-10 0.00364128
9.1e-10 0.00350281
9.2e-10 0.0033749
9.3e-10 0.00323987
9.4e-10 0.00310239
9.5e-10 0.00296818
9.6e-10 0.00283726
9.7e-10 0.00270962
9.8e-10 0.00258525
9.9e-10 0.00246417
1e-09 0.00234846
1.01e-09 0.00223867
1.02e-09 0.0021332
1.03e-09 0.00203202
1.04e-09 0.00193515
1.05e-09 0.00184259
1.06e-09 0.00175433
1.07e-09 0.00166969
1.08e-09 0.00158763
1.09e-09 0.00150934
1.1e-09 0.0014348
1.11e-09 0.00136403
1.12e-09 0.00129702
1.13e-09 0.00123376
1.14e-09 0.00117428
1.15e-09 0.00111855
1.16e-09 0.00106658
1.17e-09 0.00101359
1.18e-09 0.000961358
1.19e-09 0.000911597
1.2e-09 0.000864307
1.21e-09 0.000819485
1.22e-09 0.000777133
1.23e-09 0.000737249
1.24e-09 0.000699836
1.25e-09 0.000664891
1.26e-09 0.000632416
1.27e-09 0.000602409
1.28e-09 0.000574873
1.29e-09 0.000547211
1.3e-09 0.000517726
1.31e-09 0.000489737
1.32e-09 0.000463243
1.33e-09 0.000438243
1.34e-09 0.000414739
1.35e-09 0.000392729
1.36e-09 0.000372215
1.37e-09 0.000353195
1.38e-09 0.000335671
1.39e-09 0.000319641
1.4e-09 0.000305107
1.41e-09 0.000291539
1.42e-09 0.000275213
1.43e-09 0.000259676
1.44e-09 0.000244929
1.45e-09 0.000230969
1.46e-09 0.000217799
1.47e-09 0.000205417
1.48e-09 0.000193824
1.49e-09 0.00018302
1.5e-09 0.000173005
1.51e-09 0.000163778
1.52e-09 0.00015534
1.53e-09 0.000147691
1.54e-09 0.000140831
1.55e-09 0.000134759
1.56e-09 0.000128953
1.57e-09 0.000121131
1.58e-09 0.000113689
1.59e-09 0.000106628
1.6e-09 9.99462e-05
1.61e-09 9.36449e-05
1.62e-09 8.77237e-05
1.63e-09 8.21827e-05
1.64e-09 7.70218e-05
1.65e-09 7.22411e-05
1.66e-09 6.78406e-05
1.67e-09 6.38203e-05
1.68e-09 6.01801e-05
1.69e-09 5.69201e-05
1.7e-09 5.40403e-05
1.71e-09 5.15406e-05
1.72e-09 4.94211e-05
1.73e-09 4.76818e-05
1.74e-09 4.62938e-05
1.75e-09 4.32026e-05
1.76e-09 4.02712e-05
1.77e-09 3.74999e-05
1.78e-09 3.48885e-05
1.79e-09 3.2437e-05
1.8e-09 3.01455e-05
1.81e-09 2.8014e-05
1.82e-09 2.60424e-05
1.83e-09 2.42308e-05
1.84e-09 2.25791e-05
1.85e-09 2.10874e-05
1.86e-09 1.97556e-05
1.87e-09 1.85837e-05
1.88e-09 1.75719e-05
1.89e-09 1.67199e-05
1.9e-09 1.6028e-05
1.91e-09 1.5496e-05
1.92e-09 1.51239e-05
1.93e-09 1.49118e-05
1.94e-09 1.48596e-05
1.95e-09 1.49674e-05
1.96e-09 1.45721e-05
1.97e-09 1.37284e-05
1.98e-09 1.29368e-05
1.99e-09 1.21973e-05
2e-09 1.15098e-05
2.01e-09 1.08745e-05
2.02e-09 1.02912e-05
2.03e-09 9.76001e-06
2.04e-09 9.28091e-06
2.05e-09 8.8539e-06
2.06e-09 8.47896e-06
2.07e-09 8.15611e-06
2.08e-09 7.88534e-06
2.09e-09 7.66666e-06
2.1e-09 7.50007e-06
2.11e-09 7.38555e-06
2.12e-09 7.32312e-06
2.13e-09 7.31277e-06
2.14e-09 7.35451e-06
2.15e-09 7.44834e-06
2.16e-09 7.59424e-06
2.17e-09 7.79222e-06
2.18e-09 8.04231e-06
2.19e-09 8.34445e-06
2.2e-09 8.6987e-06
2.21e-09 9.10503e-06
2.22e-09 9.56343e-06
2.23e-09 9.65928e-06
2.24e-09 9.6251e-06
2.25e-09 9.60226e-06
2.26e-09 9.59078e-06
2.27e-09 9.59063e-06
2.28e-09 9.60184e-06
2.29e-09 9.62439e-06
2.3e-09 9.65829e-06
2.31e-09 9.70353e-06
2.32e-09 9.76011e-06
2.33e-09 9.82804e-06
2.34e-09 9.90732e-06
2.35e-09 9.99795e-06
2.36e-09 1.00999e-05
2.37e-09 1.02132e-05
2.38e-09 1.03379e-05
2.39e-09 1.04739e-05
2.4e-09 1.06213e-05
2.41e-09 1.078e-05
2.42e-09 1.095e-05
2.43e-09 1.11314e-05
2.44e-09 1.13241e-05
2.45e-09 1.15282e-05
2.46e-09 1.17436e-05
2.47e-09 1.19704e-05
2.48e-09 1.22085e-05
2.49e-09 1.2458e-05
2.5e-09 1.27188e-05
2.51e-09 1.2991e-05
2.52e-09 1.32745e-05
2.53e-09 1.35693e-05
2.54e-09 1.37912e-05
2.55e-09 1.39123e-05
2.56e-09 1.40329e-05
2.57e-09 1.4153e-05
2.58e-09 1.42727e-05
2.59e-09 1.43918e-05
2.6e-09 1.45105e-05
2.61e-09 1.46286e-05
2.62e-09 1.47463e-05
2.63e-09 1.48635e-05
2.64e-09 1.49801e-05
2.65e-09 1.50963e-05
2.66e-09 1.5212e-05
2.67e-09 1.53273e-05
2.68e-09 1.5442e-05
2.69e-09 1.55562e-05
2.7e-09 1.56699e-05
2.71e-09 1.57832e-05
2.72e-09 1.58959e-05
2.73e-09 1.60082e-05
2.74e-09 1.61199e-05
2.75e-09 1.62312e-05
2.76e-09 1.6342e-05
2.77e-09 1.64523e-05
2.78e-09 1.65621e-05
2.79e-09 1.66714e-05
2.8e-09 1.67802e-05
2.81e-09 1.68885e-05
2.82e-09 1.69964e-05
2.83e-09 1.71037e-05
2.84e-09 1.72106e-05
2.85e-09 1.73169e-05
2.86e-09 1.74228e-05
2.87e-09 1.75281e-05
2.88e-09 1.7633e-05
2.89e-09 1.77374e-05
2.9e-09 1.78413e-05
2.91e-09 1.79447e-05
2.92e-09 1.80476e-05
2.93e-09 1.81425e-05
2.94e-09 1.82211e-05
2.95e-09 1.82981e-05
2.96e-09 1.83735e-05
2.97e-09 1.84473e-05
2.98e-09 1.85194e-05
2.99e-09 1.85898e-05
3e-09 1.86587e-05
3.01e-09 1.87259e-05
3.02e-09 1.87915e-05
3.03e-09 1.88554e-05
3.04e-09 1.89177e-05
3.05e-09 1.89784e-05
3.06e-09 1.90375e-05
3.07e-09 1.90949e-05
3.08e-09 1.91506e-05
3.09e-09 1.92048e-05
3.1e-09 1.92573e-05
3.11e-09 1.93082e-05
3.12e-09 1.93574e-05
3.13e-09 1.9405e-05
3.14e-09 1.9451e-05
3.15e-09 1.94953e-05
3.16e-09 1.9538e-05
3.17e-09 1.95791e-05
3.18e-09 1.96186e-05
3.19e-09 1.96564e-05
3.2e-09 1.96925e-05
3.21e-09 1.97271e-05
3.22e-09 1.976e-05
3.23e-09 1.97913e-05
3.24e-09 1.98209e-05
3.25e-09 1.98489e-05
3.26e-09 1.98753e-05
3.27e-09 1.99e-05
3.28e-09 1.99231e-05
3.29e-09 1.99446e-05
3.3e-09 1.99644e-05
3.31e-09 1.99826e-05
3.32e-09 2.00024e-05
3.33e-09 2.00319e-05
3.34e-09 2.00605e-05
3.35e-09 2.00882e-05
3.36e-09 2.0115e-05
3.37e-09 2.01409e-05
3.38e-09 2.01658e-05
3.39e-09 2.01899e-05
3.4e-09 2.0213e-05
3.41e-09 2.02352e-05
3.42e-09 2.02565e-05
3.43e-09 2.02769e-05
3.44e-09 2.02963e-05
3.45e-09 2.03149e-05
3.46e-09 2.03325e-05
3.47e-09 2.03492e-05
3.48e-09 2.0365e-05
3.49e-09 2.038e-05
3.5e-09 2.03939e-05
End tv FallingWaveform name=fall_2

DATAPOINTS PARASITICS
C_COMP=8.47516e-13
END PARASITICS

END BDRVR SN65MLVD040_ROUT_Typ_27degC
DATAPOINTS BDRVR SPARTAN7_LVCMOS33_S_12_HR_Typ_27degC
MODEL_VERSION=2.0
PullUpReference=3.3
PullDownReference=0
PowerClampReference=3.3
GroundClampReference=0

DATAPOINTS AC_PARAM
dVGateOpen=1
dVGateClose=0
ENABLE_ON_VOLT=1
ENABLE_OFF_VOLT=0
RISE_TIME=2.40983e-09
FALL_TIME=1.399e-09
dVdtr=9.49028e+08
dVdtf=1.76614e+09
END AC_PARAM

DATAPOINTS LOGIC_PARAM
VHI_MIN=2
VLO_MAX=0.8
END LOGIC_PARAM

DATAPOINTS VI POWER_CLAMP
3.28 3.564
3.24 3.502
3.2 3.441
3.16 3.379
3.12 3.318
3.08 3.256
3.04 3.195
3 3.133
2.96 3.072
2.92 3.01
2.88 2.949
2.84 2.887
2.8 2.826
2.76 2.765
2.72 2.703
2.68 2.642
2.64 2.58
2.6 2.519
2.56 2.457
2.52 2.396
2.48 2.334
2.44 2.273
2.4 2.211
2.36 2.15
2.32 2.088
2.28 2.027
2.24 1.966
2.2 1.904
2.16 1.843
2.12 1.781
2.08 1.72
2.04 1.658
2 1.597
1.96 1.535
1.92 1.474
1.88 1.412
1.84 1.351
1.8 1.29
1.76 1.228
1.72 1.167
1.68 1.105
1.64 1.044
1.6 0.9827
1.56 0.9213
1.52 0.86
1.48 0.7987
1.44 0.7375
1.4 0.6762
1.36 0.615
1.32 0.5553
1.28 0.4967
1.24 0.4381
1.2 0.3796
1.16 0.321
1.12 0.2663
1.08 0.2147
1.04 0.163
1 0.118
0.96 0.08102
0.92 0.05554
0.88 0.04138
0.84 0.03316
0.8 0.02805
0.76 0.0245
0.72 0.02113
0.68 0.01775
0.64 0.01437
0.6 0.01099
0.56 0.008919
0.52 0.006984
0.48 0.00505
0.44 0.003116
0.4 0.001182
0.36 0.0007935
0.32 0.0005628
0.28 0.0003322
0.24 0.0001015
0.2 4.709e-06
0.16 2.65e-06
0.12 5.904e-07
0.08 7.907e-08
0.04 2.938e-08
0 1.962e-08
END VI POWER_CLAMP

DATAPOINTS VI ground_clamp
-3.3 -3.592
-3.23 -3.485
-3.16 -3.378
-3.09 -3.271
-3.02 -3.164
-2.95 -3.057
-2.88 -2.95
-2.81 -2.844
-2.74 -2.737
-2.67 -2.63
-2.6 -2.523
-2.53 -2.416
-2.46 -2.309
-2.39 -2.202
-2.32 -2.095
-2.25 -1.988
-2.18 -1.881
-2.11 -1.774
-2.04 -1.668
-1.97 -1.561
-1.9 -1.454
-1.83 -1.347
-1.76 -1.24
-1.69 -1.133
-1.62 -1.027
-1.55 -0.9221
-1.48 -0.8171
-1.41 -0.7121
-1.34 -0.607
-1.27 -0.505
-1.2 -0.4209
-1.13 -0.3369
-1.06 -0.2528
-0.99 -0.1688
-0.92 -0.0923
-0.85 -0.06205
-0.78 -0.04515
-0.71 -0.03339
-0.64 -0.02163
-0.57 -0.01324
-0.5 -0.006516
-0.43 -0.001313
-0.36 -0.0002249
-0.29 -3.255e-05
-0.22 -6.704e-06
-0.15 -4.021e-07
-0.08 -3.203e-08
-0.01 -1.438e-08
0.06 -1.227e-08
0.13 -1.136e-08
0.2 -1.075e-08
0.27 -1.027e-08
0.34 -9.826e-09
0.41 -9.414e-09
0.48 -9.005e-09
0.55 -8.613e-09
0.62 -8.225e-09
0.69 -7.845e-09
0.76 -7.466e-09
0.83 -7.088e-09
0.9 -6.711e-09
0.97 -6.335e-09
1.04 -5.955e-09
1.11 -5.579e-09
1.18 -5.198e-09
1.25 -4.833e-09
1.32 -4.482e-09
1.39 -4.123e-09
1.46 -3.738e-09
1.53 -3.199e-09
1.6 -2.521e-09
1.67 -1.751e-09
1.74 -9.51e-10
1.81 -3.026e-10
1.88 5.343e-10
1.95 1.529e-09
2.02 2.077e-09
2.09 2.572e-09
2.16 3.18e-09
2.23 3.744e-09
2.3 4.274e-09
2.37 4.807e-09
2.44 5.354e-09
2.51 5.902e-09
2.58 6.45e-09
2.65 7.019e-09
2.72 7.641e-09
2.79 8.264e-09
2.86 8.886e-09
2.93 9.509e-09
3 1.024e-08
3.07 1.148e-08
3.14 1.411e-08
3.21 1.675e-08
3.28 1.939e-08
END VI ground_clamp

DATAPOINTS VI PULL_UP
3.3 0.03786
3.2 0.03786
3.1 0.03786
3 0.03786
2.9 0.03786
2.8 0.03786
2.7 0.03786
2.6 0.03786
2.5 0.03786
2.4 0.03786
2.3 0.03786
2.2 0.03786
2.1 0.03786
2 0.03786
1.9 0.03786
1.8 0.03786
1.7 0.03786
1.6 0.03786
1.5 0.03786
1.4 0.03786
1.3 0.03786
1.2 0.03786
1.1 0.03786
1 0.03786
0.9 0.03786
0.8 0.03786
0.7 0.03595
0.6 0.0352
0.5 0.031471
0.4 0.025401
0.3 0.0205318
0.2 0.0139834
0.1 0.0069299
0 4.936e-08
-0.1 -0.006506
-0.2 -0.01284
-0.3 -0.0186
-0.4 -0.0239
-0.5 -0.0287
-0.6 -0.03286
-0.7 -0.03685
-0.8 -0.04031
-0.9 -0.04327
-1 -0.04559
-1.1 -0.04751
-1.2 -0.04886
-1.3 -0.04977
-1.4 -0.05037
-1.5 -0.05081
-1.6 -0.05115
-1.7 -0.05144
-1.8 -0.0517
-1.9 -0.05193
-2 -0.05214
-2.1 -0.05235
-2.2 -0.05254
-2.3 -0.05272
-2.4 -0.05289
-2.5 -0.06212
-2.6 -0.06225
-2.7 -0.06238
-2.8 -0.0625
-2.9 -0.06262
-3 -0.06274
-3.1 -0.06285
-3.2 -0.06296
-3.3 -0.06307
-3.4 -0.0631799
-3.5 -0.0632986
-3.6 -0.0633507
-3.7 -0.0633507
-3.8 -0.0633507
-3.9 -0.0633507
-4 -0.0633507
-4.1 -0.0633507
-4.2 -0.0633507
-4.3 -0.0633507
-4.4 -0.0633507
-4.5 -0.0633507
-4.6 -0.0633507
-4.7 -0.0633507
-4.8 -0.0633507
-4.9 -0.0633507
-5 -0.0633507
-5.1 -0.0633507
-5.2 -0.0633507
-5.3 -0.0633507
-5.4 -0.0633507
-5.5 -0.0633507
-5.6 -0.0633507
-5.7 -0.0633507
-5.8 -0.0633507
-5.9 -0.0633507
-6 -0.0633507
-6.1 -0.0633507
-6.2 -0.0633507
-6.3 -0.0633507
-6.4 -0.0633507
-6.5 -0.0633507
-6.6 -0.0633507
END VI PULL_UP

DATAPOINTS VI pull_down
-3.3 -0.04225
-3.2 -0.04225
-3.1 -0.04225
-3 -0.04225
-2.9 -0.04225
-2.8 -0.04225
-2.7 -0.04225
-2.6 -0.04225
-2.5 -0.04225
-2.4 -0.04225
-2.3 -0.04225
-2.2 -0.04225
-2.1 -0.04225
-2 -0.04225
-1.9 -0.04225
-1.8 -0.04225
-1.7 -0.04225
-1.6 -0.04225
-1.5 -0.04225
-1.4 -0.04225
-1.3 -0.04225
-1.2 -0.04225
-1.1 -0.04225
-1 -0.04225
-0.9 -0.04225
-0.8 -0.04225
-0.7 -0.04225
-0.6 -0.04225
-0.5 -0.041786
-0.4 -0.0381758
-0.3 -0.0288013
-0.2 -0.0187488
-0.1 -0.0089709
0 0.0008109
0.1 0.009922
0.2 0.01686
0.3 0.0238
0.4 0.03074
0.5 0.03767
0.6 0.0418
0.7 0.04518
0.8 0.04856
0.9 0.05169
1 0.05236
1.1 0.05303
1.2 0.0537
1.3 0.05428
1.4 0.05455
1.5 0.05483
1.6 0.0551
1.7 0.05512
1.8 0.05522
1.9 0.05532
2 0.05556
2.1 0.05562
2.2 0.0558
2.3 0.0558
2.4 0.05592
2.5 0.06033
2.6 0.06064
2.7 0.06075
2.8 0.06076
2.9 0.06082
3 0.06083
3.1 0.0608999
3.2 0.0611586
3.3 0.0611586
3.4 0.0611586
3.5 0.0611586
3.6 0.0611586
3.7 0.0611586
3.8 0.0611586
3.9 0.0611586
4 0.0611586
4.1 0.0611586
4.2 0.0611586
4.3 0.0611586
4.4 0.0611586
4.5 0.0611586
4.6 0.0611586
4.7 0.0611586
4.8 0.0611586
4.9 0.0611586
5 0.0611586
5.1 0.0611586
5.2 0.0611586
5.3 0.0611586
5.4 0.0611586
5.5 0.0611586
5.6 0.0611586
5.7 0.0611586
5.8 0.0611586
5.9 0.0611586
6 0.0611586
6.1 0.0611586
6.2 0.0611586
6.3 0.0611586
6.4 0.0611586
6.5 0.0611586
6.6 0.0611586
END VI pull_down
datapoints tv RisingWaveform name=rise_1 R_fixture=50 V_fixture=3.3 
0 0.8292
2.5e-10 0.8292
5.1e-10 0.8291
7.6e-10 0.8261
1.01e-09 1.605
1.26e-09 2.93
1.52e-09 3.249
1.77e-09 3.288
2.02e-09 3.296
2.27e-09 3.297
2.53e-09 3.298
2.78e-09 3.298
3.03e-09 3.299
3.28e-09 3.299
3.54e-09 3.299
3.79e-09 3.299
4.04e-09 3.299
4.29e-09 3.299
4.55e-09 3.299
4.8e-09 3.299
5.05e-09 3.299
5.3e-09 3.299
5.56e-09 3.299
5.81e-09 3.299
6.06e-09 3.299
6.31e-09 3.299
6.57e-09 3.299
6.82e-09 3.299
7.07e-09 3.299
7.32e-09 3.299
7.58e-09 3.299
7.83e-09 3.299
8.08e-09 3.299
8.33e-09 3.299
8.59e-09 3.299
8.84e-09 3.299
9.09e-09 3.299
9.34e-09 3.299
9.6e-09 3.299
9.85e-09 3.299
1.01e-08 3.299
1.035e-08 3.299
1.061e-08 3.299
1.086e-08 3.299
1.111e-08 3.299
1.136e-08 3.299
1.162e-08 3.299
1.187e-08 3.299
1.212e-08 3.299
1.237e-08 3.299
1.263e-08 3.299
1.288e-08 3.299
1.313e-08 3.299
1.338e-08 3.299
1.364e-08 3.299
1.389e-08 3.299
1.414e-08 3.299
1.439e-08 3.299
1.465e-08 3.299
1.49e-08 3.299
1.515e-08 3.299
1.54e-08 3.299
1.566e-08 3.299
1.591e-08 3.299
1.616e-08 3.299
1.641e-08 3.299
1.667e-08 3.299
1.692e-08 3.299
1.717e-08 3.299
1.742e-08 3.299
1.768e-08 3.299
1.793e-08 3.3
1.818e-08 3.3
1.843e-08 3.3
1.869e-08 3.3
1.894e-08 3.3
4.4157e-08 3.3
End tv RisingWaveform name=rise_1
datapoints tv RisingWaveform name=rise_2 R_fixture=50 V_fixture=0 
0 0
1.4918e-10 2.7819e-06
2.9836e-10 3.5266e-06
4.4753e-10 2.3775e-08
5.9671e-10 -0.0002334
7.4589e-10 -0.00063245
8.9507e-10 0.0018535
1.0442e-09 0.066173
1.1934e-09 0.33702
1.3426e-09 0.646
1.4918e-09 0.98573
1.641e-09 1.2648
1.7901e-09 1.5081
1.9393e-09 1.6125
2.0885e-09 1.6917
2.2377e-09 1.7413
2.3868e-09 1.7749
2.536e-09 1.8038
2.6852e-09 1.8241
2.8344e-09 1.8442
2.9836e-09 1.8639
3.1327e-09 1.884
3.2819e-09 1.9042
3.4311e-09 1.922
3.5803e-09 1.9397
3.7294e-09 1.957
3.8786e-09 1.9732
4.0278e-09 1.9887
4.177e-09 2.0031
4.3262e-09 2.0171
4.4753e-09 2.0297
4.6245e-09 2.0414
4.7737e-09 2.0521
4.9229e-09 2.0624
5.072e-09 2.0726
5.2212e-09 2.0833
5.3704e-09 2.0931
5.5196e-09 2.1017
5.6688e-09 2.1092
5.8179e-09 2.1164
5.9671e-09 2.1235
6.1163e-09 2.1305
6.2655e-09 2.137
6.4146e-09 2.1434
6.5638e-09 2.1497
6.713e-09 2.1546
6.8622e-09 2.1593
7.0113e-09 2.1641
7.1605e-09 2.1689
7.3097e-09 2.1737
7.4589e-09 2.1777
7.6081e-09 2.1819
7.7572e-09 2.1867
7.9064e-09 2.1908
8.0556e-09 2.1944
8.2048e-09 2.1975
8.3539e-09 2.2005
8.5031e-09 2.2033
8.6523e-09 2.2062
8.8015e-09 2.2092
8.9507e-09 2.2122
9.0998e-09 2.2152
9.249e-09 2.2175
9.3982e-09 2.2199
9.5474e-09 2.2222
9.6965e-09 2.2242
9.8457e-09 2.2259
9.9949e-09 2.2283
1.0144e-08 2.2305
1.0293e-08 2.2323
1.0442e-08 2.2341
1.0592e-08 2.2358
1.0741e-08 2.2376
1.089e-08 2.2392
1.1039e-08 2.2404
1.1188e-08 2.2419
1.1338e-08 2.2437
1.1487e-08 2.245
1.1636e-08 2.2461
1.1785e-08 2.2473
1.1934e-08 2.2485
1.2083e-08 2.2497
1.2233e-08 2.2514
1.2382e-08 2.2531
1.2531e-08 2.2549
1.268e-08 2.2562
1.2829e-08 2.2568
1.2978e-08 2.2578
1.3128e-08 2.259
1.3277e-08 2.2596
1.3426e-08 2.2604
1.3575e-08 2.2615
1.3724e-08 2.2623
1.3874e-08 2.2629
1.4023e-08 2.2635
1.4172e-08 2.2641
1.4321e-08 2.2647
1.447e-08 2.2653
1.4619e-08 2.2659
1.4769e-08 2.2669
1.4918e-08 2.2681
1.5067e-08 2.2687
1.5216e-08 2.2693
1.5365e-08 2.2699
1.5514e-08 2.2704
1.5664e-08 2.271
1.5813e-08 2.271
1.5962e-08 2.2712
1.6111e-08 2.2718
1.626e-08 2.2724
1.641e-08 2.273
1.6559e-08 2.2736
1.6708e-08 2.2742
1.6857e-08 2.2747
1.7006e-08 2.275
1.7155e-08 2.275
1.7305e-08 2.2755
1.7454e-08 2.2761
1.7603e-08 2.2767
1.7752e-08 2.277
1.7901e-08 2.277
1.805e-08 2.2775
1.82e-08 2.278
1.8349e-08 2.278
1.8498e-08 2.2783
1.8647e-08 2.2788
1.8796e-08 2.279
1.8946e-08 2.279
1.9095e-08 2.2796
1.9244e-08 2.28
1.9393e-08 2.28
1.9542e-08 2.2804
1.9691e-08 2.281
1.9841e-08 2.281
1.999e-08 2.2812
2.0139e-08 2.2818
2.0288e-08 2.282
2.0437e-08 2.282
2.0587e-08 2.282
2.0736e-08 2.2821
2.0885e-08 2.2827
2.1034e-08 2.283
2.1183e-08 2.283
2.1332e-08 2.283
2.1482e-08 2.2831
2.1631e-08 2.2837
2.178e-08 2.284
2.1929e-08 2.284
2.2078e-08 2.284
2.2227e-08 2.284
2.2377e-08 2.284
2.2526e-08 2.2842
2.2675e-08 2.2848
2.2824e-08 2.285
2.2973e-08 2.285
2.3123e-08 2.285
2.3272e-08 2.285
2.3421e-08 2.285
2.357e-08 2.2853
2.3719e-08 2.2859
2.3868e-08 2.286
2.4018e-08 2.286
2.4167e-08 2.286
2.4316e-08 2.286
2.4465e-08 2.286
2.4614e-08 2.2865
2.4763e-08 2.287
2.4913e-08 2.287
2.5062e-08 2.287
2.5211e-08 2.287
2.536e-08 2.287
2.5509e-08 2.287
2.5659e-08 2.287
2.5808e-08 2.287
2.5957e-08 2.287
2.6106e-08 2.287
2.6255e-08 2.287
2.6404e-08 2.287
2.6554e-08 2.287
2.6703e-08 2.287
2.6852e-08 2.287
2.7001e-08 2.287
2.715e-08 2.287
2.73e-08 2.287
2.7449e-08 2.287
2.7598e-08 2.287
2.7747e-08 2.287
2.7896e-08 2.287
2.8045e-08 2.287
2.8195e-08 2.287
2.8344e-08 2.287
2.8493e-08 2.287
2.8642e-08 2.287
2.8791e-08 2.287
2.894e-08 2.287
2.909e-08 2.287
2.9239e-08 2.287
2.9388e-08 2.287
2.9537e-08 2.287
2.9686e-08 2.287
2.9836e-08 2.287
2.9985e-08 2.287
3.0134e-08 2.287
3.0283e-08 2.287
3.0432e-08 2.287
3.0581e-08 2.287
3.0731e-08 2.287
3.088e-08 2.287
3.1029e-08 2.287
3.1178e-08 2.287
3.1327e-08 2.287
3.1476e-08 2.287
3.1626e-08 2.287
3.1775e-08 2.287
3.1924e-08 2.287
3.2073e-08 2.287
3.2222e-08 2.287
3.2372e-08 2.287
3.2521e-08 2.287
3.267e-08 2.287
3.2819e-08 2.287
3.2968e-08 2.287
3.3117e-08 2.287
3.3267e-08 2.287
3.3416e-08 2.287
3.3565e-08 2.287
3.3714e-08 2.287
3.3863e-08 2.287
3.4013e-08 2.287
3.4162e-08 2.287
3.4311e-08 2.287
3.446e-08 2.287
3.4609e-08 2.287
3.4758e-08 2.287
3.4908e-08 2.287
3.5057e-08 2.287
3.5206e-08 2.287
3.5355e-08 2.287
3.5504e-08 2.287
3.5653e-08 2.287
3.5803e-08 2.287
3.5952e-08 2.287
3.6101e-08 2.287
3.625e-08 2.287
3.6399e-08 2.287
3.6549e-08 2.287
3.6698e-08 2.287
3.6847e-08 2.287
3.6996e-08 2.287
3.7145e-08 2.287
3.7294e-08 2.287
3.7444e-08 2.287
3.7593e-08 2.287
3.7742e-08 2.287
3.7891e-08 2.287
3.804e-08 2.287
3.8189e-08 2.287
3.8339e-08 2.287
3.8488e-08 2.287
3.8637e-08 2.287
3.8786e-08 2.287
3.8935e-08 2.287
3.9085e-08 2.287
3.9234e-08 2.287
3.9383e-08 2.287
3.9532e-08 2.287
3.9681e-08 2.287
3.983e-08 2.287
3.998e-08 2.287
4.0129e-08 2.287
4.0278e-08 2.287
4.0427e-08 2.287
4.0576e-08 2.287
4.0725e-08 2.287
4.0875e-08 2.287
4.1024e-08 2.287
4.1173e-08 2.287
4.1322e-08 2.287
4.1471e-08 2.287
4.1621e-08 2.287
4.177e-08 2.287
4.1919e-08 2.287
4.2068e-08 2.287
4.2217e-08 2.287
4.2366e-08 2.287
4.2516e-08 2.287
4.2665e-08 2.287
4.2814e-08 2.287
4.2963e-08 2.287
4.3112e-08 2.287
4.3262e-08 2.287
4.3411e-08 2.287
4.356e-08 2.287
4.3709e-08 2.287
4.3858e-08 2.287
4.4007e-08 2.287
4.4157e-08 2.287
End tv RisingWaveform name=rise_2
datapoints tv FallingWaveform name=fall_1 R_fixture=50 V_fixture=3.3 
0 3.3
2.5e-10 3.3
5.1e-10 3.3
7.6e-10 3.301
1.01e-09 3.301
1.26e-09 3.315
1.52e-09 3.255
1.77e-09 2.943
2.02e-09 2.474
2.27e-09 1.969
2.53e-09 1.521
2.78e-09 1.217
3.03e-09 1.036
3.28e-09 0.9409
3.54e-09 0.9083
3.79e-09 0.8844
4.04e-09 0.8673
4.29e-09 0.8544
4.55e-09 0.8439
4.8e-09 0.8381
5.05e-09 0.8346
5.3e-09 0.833
5.56e-09 0.8315
5.81e-09 0.8308
6.06e-09 0.8302
6.31e-09 0.8297
6.57e-09 0.8296
6.82e-09 0.8296
7.07e-09 0.8295
7.32e-09 0.8295
7.58e-09 0.8294
7.83e-09 0.8294
8.08e-09 0.8293
8.33e-09 0.8293
8.59e-09 0.8292
8.84e-09 0.8293
9.09e-09 0.8293
9.34e-09 0.8293
9.6e-09 0.8293
9.85e-09 0.8294
1.01e-08 0.8293
1.035e-08 0.8293
1.061e-08 0.8293
1.086e-08 0.8292
1.111e-08 0.8292
1.136e-08 0.8292
1.162e-08 0.8292
1.187e-08 0.8293
1.212e-08 0.8293
1.237e-08 0.8293
1.263e-08 0.8293
1.288e-08 0.8292
1.313e-08 0.8292
1.338e-08 0.8292
1.364e-08 0.8292
1.389e-08 0.8292
1.414e-08 0.8292
1.439e-08 0.8292
1.465e-08 0.8292
1.49e-08 0.8292
1.515e-08 0.8292
End tv FallingWaveform name=fall_1
datapoints tv FallingWaveform name=fall_2 R_fixture=50 V_fixture=0 
0 2.291
2.5e-10 2.291
5.1e-10 2.291
7.6e-10 2.294
1.01e-09 2.293
1.26e-09 1.489
1.52e-09 0.7454
1.77e-09 0.292
2.02e-09 0.03907
2.27e-09 0.004489
2.53e-09 0.0008558
2.78e-09 0.0006007
3.03e-09 0.0003783
3.28e-09 0.000263
3.54e-09 0.000196
3.79e-09 0.0001369
4.04e-09 0
4.29e-09 0
4.55e-09 0
4.8e-09 0
5.05e-09 0
5.3e-09 0
5.56e-09 0
5.81e-09 0
6.06e-09 0
6.31e-09 0
6.57e-09 0
1.515e-08 0
End tv FallingWaveform name=fall_2

DATAPOINTS PARASITICS
C_COMP=5.23e-12
END PARASITICS

END BDRVR SPARTAN7_LVCMOS33_S_12_HR_Typ_27degC
